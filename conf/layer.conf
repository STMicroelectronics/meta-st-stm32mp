## conf/machine/stm32mp25-disco.conf
```bitbake
#@TYPE: Machine
#@NAME: stm32mp25-disco
#@DESCRIPTION: Configuration STM32MP25 disco boards (DK)
#@NEEDED_BSPLAYERS: layers/meta-openembedded/meta-oe layers/meta-openembedded/meta-python

# Define specific familly common machine name
MACHINEOVERRIDES =. "stm32mp2common:stm32mp25common:"

include conf/machine/include/st-machine-common-stm32mp.inc
include conf/machine/include/st-machine-providers-stm32mp.inc

# =========================================================================
# Chip architecture
# =========================================================================
DEFAULTTUNE = "cortexa35"
include conf/machine/include/arm/armv8a/tune-cortexa35.inc

# =========================================================================
# boot scheme
# =========================================================================
BOOTSCHEME_LABELS = "optee"

# =========================================================================
# boot device
# =========================================================================
# Define the boot device supported
BOOTDEVICE_LABELS += "sdcard"

# =========================================================================
# OPTEE profile
# =========================================================================
# Optee profile, permit to activate or desactvate a list of service on optee.
# There is two configuration available:
#  - secure_and_system_services aka optee boot scheme
#  - system_services aka opteemin boot scheme

# Default optee profile use by all soc, (if exception see if there is a specific
# profile for a soc)
ST_OPTEE_PROFILE ?= "secure_and_system_services"
ST_OPTEE_EXPORT_TA_REF_BOARD:stm32mp2common = "stm32mp257f-dk.dts"
# =========================================================================
# Machine settings
# =========================================================================
# activate external dt
EXTERNAL_DT_ENABLED = "1"

# Define list of devicetree per supported storage
STM32MP_DT_FILES_SDCARD += "stm32mp257f-dk"

EXTERNAL_DEVICETREE_SDCARD = ""
EXTERNAL_DEVICETREE_SDCARD = "stm32mp257f-dk-ca35tdcid-ostl"
EXTERNAL_DEVICETREE_SDCARD =+ "stm32mp257f-dk-ca35tdcid-ostl-m33-examples"

# =========================================================================
# Machine features
# =========================================================================
MACHINE_FEATURES += "splashscreen"
MACHINE_FEATURES += "watchdog"
MACHINE_FEATURES += "bluetooth"
MACHINE_FEATURES += "wifi"

# GPU
MACHINE_FEATURES += "${@'gpu' if d.getVar('ACCEPT_EULA_'+d.getVar('MACHINE')) == '1' else ''}"
MACHINE_FEATURES += "${@'openvx' if d.getVar('ACCEPT_EULA_'+d.getVar('MACHINE')) == '1' else ''}"
MACHINE_FEATURES += "${@'opencl' if d.getVar('ACCEPT_EULA_'+d.getVar('MACHINE')) == '1' else ''}"
MACHINE_FEATURES += "${@'vulkan' if d.getVar('ACCEPT_EULA_'+d.getVar('MACHINE')) == '1' else ''}"

# M33
MACHINE_FEATURES += "m33copro"

# Bluetooth
BLUETOOTH_LIST += "linux-firmware-bluetooth-bcm4343"
# Wifi
WIFI_LIST += "linux-firmware-bcm43439"
# PCIe
PCI_LIST += "linux-firmware-rtl8168"

# ==========================================================================
# M33 Boards
# ==========================================================================
# Lists of boards/devicetree on which the m33 service MUST be started
M33_BOARDS_START_AT_STARTUP = "stm32mp257f-dk"
M33_BOARDS_START_AT_STARTUP =+ "${@bb.utils.contains('EXTERNAL_DT_ENABLED', '1', 'stm32mp257f-dk-ca35tdcid-ostl', '', d)}"

# =========================================================================
# WIC for sdcard raw image
# =========================================================================
WIC_CREATE_EXTRA_ARGS = "--no-fstab-update"
WKS_FILE_DEPENDS ?= " \
    virtual/bootloader \
    virtual/trusted-firmware-a \
    virtual/optee-os \
    st-image-bootfs \
    ${@bb.utils.contains('ST_VENDORFS','1','st-image-vendorfs', '', d)} \
    st-image-userfs \
"
OPTEE_WIC_FILE = "${@bb.utils.contains('ST_VENDORFS','1','sdcard-stm32mp257f-dk-optee-vendorfs-1GB.wks.in','sdcard-stm32mp257f-dk-optee-1GB.wks.in',d)}"

# for generated a WIC file, please uncomment the 2 following lines or add them to local.conf
#WKS_IMAGE_FSTYPES += "wic wic.bz2 wic.bmap"
#WKS_FILE += "${OPTEE_WIC_FILE}"
```

## wic/sdcard-stm32mp157c-ev1-optee-1GB.wks
```
# short-description: Create SD card image with a boot partition (1GB)
# long-description: Creates a partitioned SD card image (1GB)
#
#  - ----- --------- -------------- -----------------------------------------------------
# | | TFA | u-boot  | teeh | teed | teex |    bootfs   |    vendorfs | rootfs  | userfs |
#  - ----- --------- -------------- -----------------------------------------------------
# ^ ^     ^         ^      ^      ^      ^             ^             ^         ^        ^
# | |     |         |      |      |      |             |             |         |        |
# 0 17kB 529kB    2.5MB   2.8MB  3MB    3.3MB        67.3MiB       83.3MiB    852Mib   1024MiB
#
# Warning: the first stage of boot (here fsbl1, fsbl2, ssbl) MUST be on GPT partition to be detected.
#

part fsbl1 --source gptcopy --sourceparams="file=tf-a-stm32mp157c-ev1-optee.stm32" --ondisk mmcblk --label fsbl1 --part-type 0x8301 --fixed-size 256K --align 17
part fsbl2 --source gptcopy --sourceparams="file=tf-a-stm32mp157c-ev1-optee.stm32" --ondisk mmcblk --label fsbl2 --part-type 0x8301 --fixed-size 256K
part ssbl  --source gptcopy --sourceparams="file=u-boot-stm32mp157c-ev1-optee.stm32" --ondisk mmcblk --label ssbl --part-type 0x8301 --fixed-size 2048K

part teeh  --source gptcopy --sourceparams="file=tee-header_v2-stm32mp157c-ev1-optee.stm32" --ondisk mmcblk --label ssbl --part-type 0x8301 --fixed-size 256K
part teed  --source gptcopy --sourceparams="file=tee-pageable_v2-stm32mp157c-ev1-optee.stm32" --ondisk mmcblk --label ssbl --part-type 0x8301 --fixed-size 256K
part teex  --source gptcopy --sourceparams="file=tee-pager_v2-stm32mp157c-ev1-optee.stm32" --ondisk mmcblk --label ssbl --part-type 0x8301 --fixed-size 256K

part bootfs --source rawcopy --sourceparams="file=st-image-bootfs-openstlinux-weston-stm32mp1.ext4" --ondisk mmcblk --fstype=ext4 --label bootfs --active --fixed-size 64M
part vendorfs --source rawcopy --sourceparams="file=st-image-vendorfs-openstlinux-weston-stm32mp1.ext4" --ondisk mmcblk --fstype=ext4 --label vendorfs --active --fixed-size 16M
part / --source rootfs --ondisk mmcblk --fstype=ext4 --label rootfs --fixed-size 768M
part usrfs --source rawcopy --sourceparams="file=st-image-userfs-openstlinux-weston-stm32mp1.ext4" --ondisk mmcblk --fstype=ext4 --label userfs --active --fixed-size 172M

bootloader --ptable gpt
```
