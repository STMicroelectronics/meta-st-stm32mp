## conf/machine/stm32mp15-disco.conf
```bitbake
#@TYPE: Machine
#@NAME: stm32mp15-disco
#@DESCRIPTION: [EXAMPLE] STM32MP157F-DK2 board ONLY with Optee boot and SDcard support
#@NEEDED_BSPLAYERS: layers/meta-openembedded/meta-oe layers/meta-openembedded/meta-python

# Define specific familly common machine name
MACHINEOVERRIDES =. "stm32mp1common:stm32mp15common:"

include conf/machine/include/st-machine-common-stm32mp.inc
include conf/machine/include/st-machine-providers-stm32mp.inc

# =========================================================================
# Chip architecture
# =========================================================================
DEFAULTTUNE = "cortexa7thf-neon-vfpv4"
include conf/machine/include/arm/armv7a/tune-cortexa7.inc

# =========================================================================
# boot scheme
# =========================================================================
BOOTSCHEME_LABELS += "opteemin"

# =========================================================================
# boot device
# =========================================================================
# Define the boot device supported
BOOTDEVICE_LABELS += "sdcard"

# =========================================================================
# Machine settings
# =========================================================================
# Define list of devicetree per supported storage
STM32MP_DT_FILES_SDCARD += "stm32mp157f-dk2"

# =========================================================================
# Machine features
# =========================================================================
MACHINE_FEATURES += "splashscreen"
MACHINE_FEATURES += "watchdog"
MACHINE_FEATURES += "bluetooth"
MACHINE_FEATURES += "wifi"
MACHINE_FEATURES += "${@'gpu' if d.getVar('ACCEPT_EULA_'+d.getVar('MACHINE')) == '1' else ''}"
MACHINE_FEATURES += "m4copro"

# Bluetooth
BLUETOOTH_LIST += "linux-firmware-addons-bcm43xx"
# Wifi
WIFI_LIST += "linux-firmware-addons-bcm43xx"

# =========================================================================
# Kernel
# =========================================================================
# For eval board: auto-load goodix module (touchscreen module)
#KERNEL_MODULE_AUTOLOAD = "goodix"

# Define the devicetree for Linux A7 examples
#LINUX_A7_EXAMPLES_DT += "stm32mp157c-dk2-a7-examples"
#LINUX_A7_EXAMPLES_DT += "stm32mp157c-ev1-a7-examples"
LINUX_A7_EXAMPLES_DT += "stm32mp157f-dk2-a7-examples"
#LINUX_A7_EXAMPLES_DT += "stm32mp157f-ev1-a7-examples"

# =========================================================================
# M4 copro
# =========================================================================
# Define the devicetree for M4 example
#CUBE_M4_EXAMPLES_DT += "stm32mp157c-dk2-m4-examples"
#CUBE_M4_EXAMPLES_DT += "stm32mp157c-ev1-m4-examples"
CUBE_M4_EXAMPLES_DT += "stm32mp157f-dk2-m4-examples"
#CUBE_M4_EXAMPLES_DT += "stm32mp157f-ev1-m4-examples"

# Define specific board reference to use
# For M4 BOARD config, STM32MP157C are similar to STM32MP157F
M4_BOARDS = "STM32MP157C-DK2"

# =========================================================================
# OPTEE
# =========================================================================
# For sdk generation, declare the default board configuration to use.
ST_OPTEE_EXPORT_TA_REF_BOARD:stm32mp1common = "stm32mp157f-dk2.dts"

# =========================================================================
# extlinux configuration
# =========================================================================
# As example, modify the default boot config to M4 config
#UBOOT_EXTLINUX_DEFAULT_LABEL:stm32mp157c-dk2 = "stm32mp157c-dk2-m4-examples"

# =========================================================================
# WIC for sdcard raw image
# =========================================================================
WIC_CREATE_EXTRA_ARGS = "--no-fstab-update"
WKS_FILE_DEPENDS ?= " \
    virtual/bootloader \
    virtual/trusted-firmware-a \
    ${@bb.utils.contains('BOOTSCHEME_LABELS', 'optee', 'virtual-optee-os', '', d)} \
    ${@bb.utils.contains('ST_BOOTFS','1','st-image-bootfs', '', d)} \
    ${@bb.utils.contains('ST_VENDORFS','1','st-image-vendorfs', '', d)} \
    ${@bb.utils.contains('ST_USERFS','1','st-image-userfs', '', d)} \
"
# the following wic file are provided as example to generate a raw image.
# Wic file configuration, request to have as minimul BOOTFS and USERFS activated
# To have a raw image which match with your usage, please create a new wic file by keeping the first
# stages (fsbl, fip, u-boot-env)
OPTEE_WIC_FILE = "${@bb.utils.contains('ST_VENDORFS','1','sdcard-stm32mp157f-dk2-optee-vendorfs-example.wks.in','sdcard-stm32mp157f-dk2-optee-example.wks.in',d)}"
OPTEEMIN_WIC_FILE = "${@bb.utils.contains('ST_VENDORFS','1','sdcard-stm32mp157f-dk2-opteemin-vendorfs-example.wks.in','sdcard-stm32mp157f-dk2-opteemin-example.wks.in',d)}"

# for generated a WIC file, please uncomment the 2 following lines or add them to local.conf
#WKS_IMAGE_FSTYPES += "wic wic.bz2 wic.bmap"
#WKS_FILE += "${OPTEE_WIC_FILE}"
#WKS_FILE += "${OPTEEMIN_WIC_FILE}"
```

## conf/machine/stm32mp15-eval.conf
```bitbake
#@TYPE: Machine
#@NAME: stm32mp15-eval
#@DESCRIPTION: [EXAMPLE] STM32MP157F-EV1 board ONLY with Optee boot and SDcard support
#@NEEDED_BSPLAYERS: layers/meta-openembedded/meta-oe layers/meta-openembedded/meta-python

# Define specific familly common machine name
MACHINEOVERRIDES =. "stm32mp1common:stm32mp15common:"

include conf/machine/include/st-machine-common-stm32mp.inc
include conf/machine/include/st-machine-providers-stm32mp.inc

# =========================================================================
# Chip architecture
# =========================================================================
DEFAULTTUNE = "cortexa7thf-neon-vfpv4"
include conf/machine/include/arm/armv7a/tune-cortexa7.inc

# =========================================================================
# boot scheme
# =========================================================================
BOOTSCHEME_LABELS += "opteemin"

# =========================================================================
# boot device
# =========================================================================
# Define the boot device supported
#BOOTDEVICE_LABELS += "emmc"
#BOOTDEVICE_LABELS += "nand-4-256-1024"
#BOOTDEVICE_LABELS += "nor-sdcard"
BOOTDEVICE_LABELS += "sdcard"

# =========================================================================
# Machine settings
# =========================================================================
# Define list of devicetree per supported storage
STM32MP_DT_FILES_EMMC   += "stm32mp157f-ev1"
STM32MP_DT_FILES_NAND   += "stm32mp157f-ev1"
STM32MP_DT_FILES_NOR_mb += "stm32mp157f-ev1"
STM32MP_DT_FILES_SDCARD += "stm32mp157f-ev1"

# =========================================================================
# Machine features
# =========================================================================
MACHINE_FEATURES += "splashscreen"
MACHINE_FEATURES += "watchdog"
#MACHINE_FEATURES += "bluetooth"
#MACHINE_FEATURES += "wifi"
MACHINE_FEATURES += "${@'gpu' if d.getVar('ACCEPT_EULA_'+d.getVar('MACHINE')) == '1' else ''}"
MACHINE_FEATURES += "m4copro"

# Bluetooth
#BLUETOOTH_LIST += "linux-firmware-addons-bcm43xx"
# Wifi
#WIFI_LIST += "linux-firmware-addons-bcm43xx"

# =========================================================================
# Kernel
# =========================================================================
# For eval board: auto-load goodix module (touchscreen module)
KERNEL_MODULE_AUTOLOAD = "goodix"

# Define the devicetree for Linux A7 examples
#LINUX_A7_EXAMPLES_DT += "stm32mp157c-dk2-a7-examples"
#LINUX_A7_EXAMPLES_DT += "stm32mp157c-ev1-a7-examples"
#LINUX_A7_EXAMPLES_DT += "stm32mp157f-dk2-a7-examples"
LINUX_A7_EXAMPLES_DT += "stm32mp157f-ev1-a7-examples"

# =========================================================================
# fit configuration
# =========================================================================
MACHINE_FEATURES += "fit"
FIT_CONF_DEFAULT_DTB = "stm32mp157f-ev1.dtb"
# =========================================================================
# M4 copro
# =========================================================================
# Define the devicetree for M4 example
#CUBE_M4_EXAMPLES_DT += "stm32mp157c-dk2-m4-examples"
#CUBE_M4_EXAMPLES_DT += "stm32mp157c-ev1-m4-examples"
#CUBE_M4_EXAMPLES_DT += "stm32mp157f-dk2-m4-examples"
CUBE_M4_EXAMPLES_DT += "stm32mp157f-ev1-m4-examples"

# Define specific board reference to use
# For M4 BOARD config, STM32MP157C are similar to STM32MP157F
M4_BOARDS = "STM32MP157C-EV1"

# =========================================================================
# extlinux configuration
# =========================================================================
# As example, modify the default boot config for each target to M4 config
#UBOOT_EXTLINUX_DEFAULT_LABEL:stm32mp157c-ev1 = "stm32mp157c-ev1-m4-examples"

# =========================================================================
# OPTEE
# =========================================================================
# For sdk generation, declare the default board configuration to use.
ST_OPTEE_EXPORT_TA_REF_BOARD:stm32mp1common = "stm32mp157f-ev1.dts"

# =========================================================================
# WIC for sdcard raw image
# =========================================================================
WIC_CREATE_EXTRA_ARGS = "--no-fstab-update"
WKS_FILE_DEPENDS ?= " \
    virtual/bootloader \
    virtual/trusted-firmware-a \
    ${@bb.utils.contains('BOOTSCHEME_LABELS', 'optee', 'virtual-optee-os', '', d)} \
    ${@bb.utils.contains('ST_BOOTFS','1','st-image-bootfs', '', d)} \
    ${@bb.utils.contains('ST_VENDORFS','1','st-image-vendorfs', '', d)} \
    ${@bb.utils.contains('ST_USERFS','1','st-image-userfs', '', d)} \
"
# the following wic file are provided as example to generate a raw image.
# Wic file configuration, request to have as minimul BOOTFS and USERFS activated
# To have a raw image which match with your usage, please create a new wic file by keeping the first
# stages (fsbl, fip, u-boot-env)
OPTEE_WIC_FILE = "${@bb.utils.contains('ST_VENDORFS','1','sdcard-stm32mp157f-ev1-optee-vendorfs-example.wks.in','sdcard-stm32mp157f-ev1-optee-example.wks.in',d)}"
OPTEEMIN_WIC_FILE = "${@bb.utils.contains('ST_VENDORFS','1','sdcard-stm32mp157f-ev1-opteemin-vendorfs-example.wks.in','sdcard-stm32mp157f-ev1-opteemin-example.wks.in',d)}"

# for generated a WIC file, please uncomment the 2 following lines or add them to local.conf
#WKS_IMAGE_FSTYPES += "wic wic.bz2 wic.bmap"
#WKS_FILE += "${OPTEE_WIC_FILE}"
#WKS_FILE += "${OPTEEMIN_WIC_FILE}"

# ---------------------------------
#  Usage of FIT Image signed
# ---------------------------------
# Need to have MACHINE_FEATURES += "fit"
# Need to uncomment the follwing variable
# NOTE: you can specify another directory to keep same key at each new compilation (UBOOT_SIGN_KEYDIR)

# keys name in keydir (eg. "ubootfit.crt", "ubootfit.key")
#UBOOT_SIGN_KEYNAME = "ubootfit"
# keys name for e&ach image in keydir (eg. "ubootimg.crt", "ubootimg.key")
#UBOOT_SIGN_IMG_KEYNAME = "ubootimg"
# for signing individualiy each image on fit (kernel, dtb aka fdt)
#FIT_SIGN_INDIVIDUAL = "1"

#UBOOT_MKIMAGE_DTCOPTS = "-I dts -O dtb -p 2000"
#UBOOT_SIGN_ENABLE = "1"
#UBOOT_SIGN_KEYDIR = "${DEPLOY_DIR_IMAGE}"

# set var for our configurations
#UBOOT_DTB_SIGNED = ""
#UBOOT_DTB_BINARY = ""

# generate key with build
#FIT_GENERATE_KEYS = "1"
```

## conf/machine/stm32mp23-disco.conf
```bitbake
#@TYPE: Machine
#@NAME: stm32mp23-disco
#@DESCRIPTION: Configuration STM32MP23 disco boards (DK)
#@NEEDED_BSPLAYERS: layers/meta-openembedded/meta-oe layers/meta-openembedded/meta-python

# Define specific familly common machine name
MACHINEOVERRIDES =. "stm32mp2common:stm32mp23common:"

include conf/machine/include/st-machine-common-stm32mp.inc
include conf/machine/include/st-machine-providers-stm32mp.inc

# =========================================================================
# Chip architecture
# =========================================================================
DEFAULTTUNE = "cortexa35"
include conf/machine/include/arm/armv8a/tune-cortexa35.inc

# =========================================================================
# boot scheme
# =========================================================================
BOOTSCHEME_LABELS = "optee"

# =========================================================================
# boot device
# =========================================================================
# Define the boot device supported
BOOTDEVICE_LABELS += "sdcard"

# =========================================================================
# Machine settings
# =========================================================================
# activate external dt
EXTERNAL_DT_ENABLED = "0"

# Define list of devicetree per supported storage
STM32MP_DT_FILES_SDCARD += "stm32mp235f-dk"

EXTERNAL_DEVICETREE_SDCARD = ""
#EXTERNAL_DEVICETREE_SDCARD = "stm32mp235f-dk-ca35tdcid-ostl"
#EXTERNAL_DEVICETREE_SDCARD =+ "stm32mp235f-dk-ca35tdcid-ostl-m33-examples"

# =========================================================================
# Machine features
# =========================================================================
MACHINE_FEATURES += "splashscreen"
MACHINE_FEATURES += "watchdog"
MACHINE_FEATURES += "bluetooth"
MACHINE_FEATURES += "wifi"

# GPU
MACHINE_FEATURES += "${@'gpu' if d.getVar('ACCEPT_EULA_'+d.getVar('MACHINE')) == '1' else ''}"
MACHINE_FEATURES += "${@'openvx' if d.getVar('ACCEPT_EULA_'+d.getVar('MACHINE')) == '1' else ''}"
MACHINE_FEATURES += "${@'opencl' if d.getVar('ACCEPT_EULA_'+d.getVar('MACHINE')) == '1' else ''}"
MACHINE_FEATURES += "${@'vulkan' if d.getVar('ACCEPT_EULA_'+d.getVar('MACHINE')) == '1' else ''}"

# M33
MACHINE_FEATURES += "m33copro"
# M0
MACHINE_FEATURES += "m0copro"

# Bluetooth
BLUETOOTH_LIST += "linux-firmware-addons-bcm43xx"
# Wifi
WIFI_LIST += "linux-firmware-addons-bcm43xx"

# --------------------------------------
# fip
# --------------------------------------
FIP_BL31_ENABLE = "1"

# ==========================================================================
# M33 Boards
# ==========================================================================
# Lists of boards/devicetree on which the m33 service MUST be started
M33_BOARDS_START_AT_STARTUP = "stm32mp235f-dk"

# =========================================================================
# OPTEE
# =========================================================================
# For sdk generation, declare the default board configuration to use.
ST_OPTEE_EXPORT_TA_REF_BOARD:stm32mp2common = "stm32mp235f-dk.dts"

# =========================================================================
# WIC for sdcard raw image
# =========================================================================
WIC_CREATE_EXTRA_ARGS = "--no-fstab-update"
WKS_FILE_DEPENDS ?= " \
    virtual/bootloader \
    virtual/trusted-firmware-a \
    virtual-optee-os \
    ${@bb.utils.contains('ST_BOOTFS','1','st-image-bootfs', '', d)} \
    ${@bb.utils.contains('ST_VENDORFS','1','st-image-vendorfs', '', d)} \
    ${@bb.utils.contains('ST_USERFS','1','st-image-userfs', '', d)} \
"
OPTEE_WIC_FILE = "${@bb.utils.contains('ST_VENDORFS','1','sdcard-stm32mp235f-dk-optee-vendorfs-2GB.wks.in','sdcard-stm32mp235f-dk-optee-2GB.wks.in',d)}"

# for generated a WIC file, please uncomment the 2 following lines or add them to local.conf
#WKS_IMAGE_FSTYPES += "wic wic.bz2 wic.bmap"
#WKS_FILE += "${OPTEE_WIC_FILE}"
```
