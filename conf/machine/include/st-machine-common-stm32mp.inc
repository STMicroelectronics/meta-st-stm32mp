## conf/machine/include/st-machine-metadata.inc
```bitbake
#@DESCRIPTION: STM32MP machine metadata firmware configuration

ENABLE_METADATA_GENERATION ?= "${@bb.utils.contains('MACHINE_FEATURES', 'fw-update', '1', '0', d)}"
METADATA_PREFIX_NAME ?= "metadata"
METADATA_SUFFIX ?= "bin"

# Manage only fip A/B
METADATA_BINARY_DEFAULT ?= "${METADATA_PREFIX_NAME}.${METADATA_SUFFIX}"

# manage FIP A/B and linux gpt image for emmc
METADATA_AB_BINARY_EMMC ?= "${METADATA_PREFIX_NAME}-ab-emmc.${METADATA_SUFFIX}"

# manage FIP A/B and linux gpt image for sdcard
METADATA_AB_BINARY_SDCARD ?= "${METADATA_PREFIX_NAME}-ab-sdcard.${METADATA_SUFFIX}"

# manage FIP A/B and linux gpt image for nor (only nor-sdcard or nor-emmc)
METADATA_AB_BINARY_NOR ?= "${METADATA_PREFIX_NAME}-ab-nor.${METADATA_SUFFIX}"
METADATA_AB_BINARY_NOR_SDCARD ?= "${METADATA_PREFIX_NAME}-ab-nor-sdcard.${METADATA_SUFFIX}"
METADATA_AB_BINARY_NOR_EMMC ?= "${METADATA_PREFIX_NAME}-ab-nor-emmc.${METADATA_SUFFIX}"

# manage FIP A/B and linux gpt image for nand (only nand-sdcard or nand-emmc)
METADATA_AB_BINARY_NAND ?= "${METADATA_PREFIX_NAME}-ab-nand.${METADATA_SUFFIX}"
METADATA_AB_BINARY_NAND_SDCARD ?= "${METADATA_PREFIX_NAME}-ab-nand-sdcard.${METADATA_SUFFIX}"
METADATA_AB_BINARY_NAND_EMMC ?= "${METADATA_PREFIX_NAME}-ab-nand-emmc.${METADATA_SUFFIX}"

# manage FIP A/B and linux gpt image for spinand (only spinand-sdcard or spinand-emmc)
METADATA_AB_BINARY_SPINAND ?= "${METADATA_PREFIX_NAME}-ab-spinand.${METADATA_SUFFIX}"
METADATA_AB_BINARY_SPINAND_SDCARD ?= "${METADATA_PREFIX_NAME}-ab-spinand-sdcard.${METADATA_SUFFIX}"
METADATA_AB_BINARY_SPINAND_EMMC ?= "${METADATA_PREFIX_NAME}-ab-spinand-emmc.${METADATA_SUFFIX}"

METADATA_AB_BINARY_EMMC ?= "${METADATA_AB_BINARY_EMMC}"
METADATA_AB_BINARY_SDCARD ?= "${METADATA_AB_BINARY_SDCARD}"
METADATA_AB_BINARY_NOR ?= "${METADATA_AB_BINARY_NOR}"
METADATA_AB_BINARY_NAND ?= "${METADATA_AB_BINARY_NAND}"
METADATA_AB_BINARY_SPINAND ?= "${METADATA_AB_BINARY_SPINAND}"

# Header version of metadata
METADATA_TOOL_VERSION ?= "2"

METADATA_TOOL_NAME ?= "mkfwumdata"

# Metadata firmware argurment for fip support only
METADATA_TOOL_ARGS_DEFAULT ?= "-g -i 1 -b 2 -v ${METADATA_TOOL_VERSION} ${DEVICE_TYPEUUID_FWU_MDATA},${DEVICE_TYPEUUID_FIP},${DEVICE_PARTUUID_FIP_A},${DEVICE_PARTUUID_FIP_B}"

# Metadata firmware support images with UUID
# Here we propose only support of linux filesystem on emmc or sdcard and boot stage on: emmc, sdcard, nor, nand or spinand

# EMMC configuration for 3 images: fip, bootfs, rootfs
METADATA_TOOL_AB_ARGS_STORAGE_EMMC ?= "-g -i 3 -b 2 -v ${METADATA_TOOL_VERSION} \
    ${DEVICE_TYPEUUID_FWU_MDATA},${DEVICE_TYPEUUID_FIP},${DEVICE_PARTUUID_FIP_A},${DEVICE_PARTUUID_FIP_B}\
    ${DEVICE_TYPEUUID_FWU_MDATA},${DEVICE_METADATA_TYPEUUID_BOOTFS},${DEVICE_PARTUUID_BOOTFS_A:EMMC},${DEVICE_PARTUUID_BOOTFS_B:EMMC}\
    ${DEVICE_TYPEUUID_FWU_MDATA},${DEVICE_METADATA_TYPEUUID_ROOTFS},${DEVICE_PARTUUID_ROOTFS_A:EMMC},${DEVICE_PARTUUID_ROOTFS_B:EMMC}"

METADATA_TOOL_AB_ARGS_EMMC ?= "${METADATA_TOOL_AB_ARGS_STORAGE_EMMC}"
METADATA_TOOL_AB_ARGS_NOR_EMMC ?= "${METADATA_TOOL_AB_ARGS_STORAGE_EMMC}"
METADATA_TOOL_AB_ARGS_NAND_EMMC ?= "${METADATA_TOOL_AB_ARGS_STORAGE_EMMC}"
METADATA_TOOL_AB_ARGS_SPINAND_EMMC ?= "${METADATA_TOOL_AB_ARGS_STORAGE_EMMC}"

# SDCARD configuration for 3 images: fip, bootfs, rootfs
METADATA_TOOL_AB_ARGS_STORAGE_SDCARD ?= "-g -i 3 -b 2 -v ${METADATA_TOOL_VERSION} \
    ${DEVICE_TYPEUUID_FWU_MDATA},${DEVICE_TYPEUUID_FIP},${DEVICE_PARTUUID_FIP_A},${DEVICE_PARTUUID_FIP_B}\
    ${DEVICE_TYPEUUID_FWU_MDATA},${DEVICE_METADATA_TYPEUUID_BOOTFS},${DEVICE_PARTUUID_BOOTFS_A:SDCARD},${DEVICE_PARTUUID_BOOTFS_B:SDCARD}\
    ${DEVICE_TYPEUUID_FWU_MDATA},${DEVICE_METADATA_TYPEUUID_ROOTFS},${DEVICE_PARTUUID_ROOTFS_A:SDCARD},${DEVICE_PARTUUID_ROOTFS_B:SDCARD}"

METADATA_TOOL_AB_ARGS_SDCARD ?= "${METADATA_TOOL_AB_ARGS_STORAGE_SDCARD}"
METADATA_TOOL_AB_ARGS_NOR_SDCARD ?= "${METADATA_TOOL_AB_ARGS_STORAGE_SDCARD}"
METADATA_TOOL_AB_ARGS_NAND_SDCARD ?= "${METADATA_TOOL_AB_ARGS_STORAGE_SDCARD}"
METADATA_TOOL_AB_ARGS_SPINAND_SDCARD ?= "${METADATA_TOOL_AB_ARGS_STORAGE_SDCARD}"

# filesystem on nor, nand or spinand are not supported, by default use fip a/b configuration
METADATA_TOOL_AB_ARGS_NOR ?= "${METADATA_TOOL_ARGS_DEFAULT}"
METADATA_TOOL_AB_ARGS_NAND ?= "${METADATA_TOOL_ARGS_DEFAULT}"
METADATA_TOOL_AB_ARGS_SPINAND ?= "${METADATA_TOOL_ARGS_DEFAULT}"

EXTRA_IMAGEDEPENDS += "${@bb.utils.contains('ENABLE_METADATA_GENERATION', '1', 'metadata', '', d)}"

# ---------------------------------------
# for TSV generation

# for metadata with firmware ab
FLASHLAYOUT_PARTITION_BIN2LOAD:sdcard:${STM32MP_METADATA_NAME} = "${@bb.utils.contains('MACHINE_FEATURES', 'fw-update-ab', 'metadata/${METADATA_AB_BINARY_SDCARD}', 'metadata/${STM32MP_METADATA_NAME_BINARY}', d)}"
FLASHLAYOUT_PARTITION_BIN2LOAD:nor-sdcard:${STM32MP_METADATA_NAME} = "${@bb.utils.contains('MACHINE_FEATURES', 'fw-update-ab', 'metadata/${METADATA_AB_BINARY_NOR_SDCARD}', 'metadata/${STM32MP_METADATA_NAME_BINARY}', d)}"
FLASHLAYOUT_PARTITION_BIN2LOAD:nand-4-256-1024:${STM32MP_METADATA_NAME} = "${@bb.utils.contains('MACHINE_FEATURES', 'fw-update-ab', 'metadata/${METADATA_AB_BINARY_NAND_SDCARD}', 'metadata/${STM32MP_METADATA_NAME_BINARY}', d)}"
FLASHLAYOUT_PARTITION_BIN2LOAD:nand-2-128-256-sdcard:${STM32MP_METADATA_NAME} = "${@bb.utils.contains('MACHINE_FEATURES', 'fw-update-ab', 'metadata/${METADATA_AB_BINARY_SPINAND_SDCARD}', 'metadata/${STM32MP_METADATA_NAME_BINARY}', d)}"
FLASHLAYOUT_PARTITION_BIN2LOAD:nand-4-256-512-sdcard:${STM32MP_METADATA_NAME} = "${@bb.utils.contains('MACHINE_FEATURES', 'fw-update-ab', 'metadata/${METADATA_AB_BINARY_SPINAND_SDCARD}', 'metadata/${STM32MP_METADATA_NAME_BINARY}', d)}"

FLASHLAYOUT_PARTITION_BIN2LOAD:emmc:${STM32MP_METADATA_NAME} = "${@bb.utils.contains('MACHINE_FEATURES', 'fw-update-ab', 'metadata/${METADATA_AB_BINARY_EMMC}', 'metadata/${STM32MP_METADATA_NAME_BINARY}', d)}"
FLASHLAYOUT_PARTITION_BIN2LOAD:nor-emmc:${STM32MP_METADATA_NAME} = "${@bb.utils.contains('MACHINE_FEATURES', 'fw-update-ab', 'metadata/${METADATA_AB_BINARY_NOR_EMMC}', 'metadata/${STM32MP_METADATA_NAME_BINARY}', d)}"
FLASHLAYOUT_PARTITION_BIN2LOAD:nand-4-256-1024-emmc:${STM32MP_METADATA_NAME} = "${@bb.utils.contains('MACHINE_FEATURES', 'fw-update-ab', 'metadata/${METADATA_AB_BINARY_NAND_EMMC}', 'metadata/${STM32MP_METADATA_NAME_BINARY}', d)}"
FLASHLAYOUT_PARTITION_BIN2LOAD:nand-2-128-256-emmc:${STM32MP_METADATA_NAME} = "${@bb.utils.contains('MACHINE_FEATURES', 'fw-update-ab', 'metadata/${METADATA_AB_BINARY_SPINAND_EMMC}', 'metadata/${STM32MP_METADATA_NAME_BINARY}', d)}"
FLASHLAYOUT_PARTITION_BIN2LOAD:nand-4-256-512-emmc:${STM32MP_METADATA_NAME} = "${@bb.utils.contains('MACHINE_FEATURES', 'fw-update-ab', 'metadata/${METADATA_AB_BINARY_SPINAND_EMMC}', 'metadata/${STM32MP_METADATA_NAME_BINARY}', d)}"

FLASHLAYOUT_PARTITION_BIN2LOAD:nor:${STM32MP_METADATA_NAME} = "${@bb.utils.contains('MACHINE_FEATURES', 'fw-update-ab', 'metadata/${METADATA_TOOL_AB_ARGS_NOR}', 'metadata/${STM32MP_METADATA_NAME_BINARY}', d)}"
FLASHLAYOUT_PARTITION_BIN2LOAD:nand-4-256-1024:${STM32MP_METADATA_NAME} = "${@bb.utils.contains('MACHINE_FEATURES', 'fw-update-ab', 'metadata/${METADATA_TOOL_AB_ARGS_NAND}', 'metadata/${STM32MP_METADATA_NAME_BINARY}', d)}"
FLASHLAYOUT_PARTITION_BIN2LOAD:nand-2-128-256:${STM32MP_METADATA_NAME} = "${@bb.utils.contains('MACHINE_FEATURES', 'fw-update-ab', 'metadata/${METADATA_TOOL_AB_ARGS_SPINAND}', 'metadata/${STM32MP_METADATA_NAME_BINARY}', d)}"
FLASHLAYOUT_PARTITION_BIN2LOAD:nand-4-256-512:${STM32MP_METADATA_NAME} = "${@bb.utils.contains('MACHINE_FEATURES', 'fw-update-ab', 'metadata/${METADATA_TOOL_AB_ARGS_SPINAND}', 'metadata/${STM32MP_METADATA_NAME_BINARY}', d)}"
```
