## conf/machine/stm32mp2.conf
```bitbake
#@TYPE: Machine
#@NAME: stm32mp2
#@DESCRIPTION: Configuration for all STM32MP2 boards (EV, DK, ...)
#@NEEDED_BSPLAYERS: layers/meta-openembedded/meta-oe layers/meta-openembedded/meta-python

# Define specific familly common machine name
MACHINEOVERRIDES =. "stm32mp2common:stm32mp25common:stm32mp23common:stm32mp21common:"

include conf/machine/include/st-machine-common-stm32mp.inc
include conf/machine/include/st-machine-providers-stm32mp.inc

# =========================================================================
# Chip architecture
# =========================================================================
DEFAULTTUNE = "cortexa35"
include conf/machine/include/arm/armv8a/tune-cortexa35.inc

# =========================================================================
# boot scheme
# =========================================================================
BOOTSCHEME_LABELS = "optee"
BOOTSCHEME_LABELS += "opteemin"
BOOTSCHEME_LABELS += "fastboot"
BOOTSCHEME_LABELS += "fastboot-opteemin"

# =========================================================================
# boot device
# =========================================================================
# Define the boot device supported
BOOTDEVICE_LABELS += "emmc"
#BOOTDEVICE_LABELS += "nand-4-256-1024"
BOOTDEVICE_LABELS += "nor-sdcard"
BOOTDEVICE_LABELS += "sdcard"

# =========================================================================
# Machine settings
# =========================================================================
# Define list of devicetree per supported storage
STM32MP_DT_FILES_SDCARD += "stm32mp215f-dk"

STM32MP_DT_FILES_EMMC   += "stm32mp235f-dk"
STM32MP_DT_FILES_SDCARD += "stm32mp235f-dk"

STM32MP_DT_FILES_EMMC   += "stm32mp257f-dk"
STM32MP_DT_FILES_SDCARD += "stm32mp257f-dk"

STM32MP_DT_FILES_EMMC   += "stm32mp257f-ev1"
STM32MP_DT_FILES_SDCARD += "stm32mp257f-ev1"
STM32MP_DT_FILES_NOR_mb += "stm32mp257f-ev1"

EXTERNAL_DEVICETREE_SDCARD = "stm32mp215f-dk-ca35tdcid-ostl"
EXTERNAL_DEVICETREE_SDCARD =+ "stm32mp215f-dk-ca35tdcid-ostl-m33-examples"
EXTERNAL_DEVICETREE_SDCARD =+ "stm32mp257f-dk-ca35tdcid-ostl"
EXTERNAL_DEVICETREE_SDCARD =+ "stm32mp257f-dk-ca35tdcid-ostl-m33-examples"
EXTERNAL_DEVICETREE_SDCARD =+ "stm32mp257f-ev1-ca35tdcid-ostl"
EXTERNAL_DEVICETREE_SDCARD =+ "stm32mp257f-ev1-ca35tdcid-ostl-m33-examples"
EXTERNAL_DEVICETREE_SDCARD =+ "stm32mp257f-ev1-ca35tdcid-ostl-m33-examples-sram"

EXTERNAL_DEVICETREE_EMMC = "stm32mp257f-dk-ca35tdcid-ostl"
EXTERNAL_DEVICETREE_EMMC =+ "stm32mp257f-dk-ca35tdcid-ostl-m33-examples"
EXTERNAL_DEVICETREE_EMMC =+ "stm32mp257f-ev1-ca35tdcid-ostl"
EXTERNAL_DEVICETREE_EMMC =+ "stm32mp257f-ev1-ca35tdcid-ostl-m33-examples"

# =========================================================================
# Machine features
# =========================================================================
MACHINE_FEATURES += "splashscreen"
MACHINE_FEATURES += "watchdog"
MACHINE_FEATURES += "bluetooth"
MACHINE_FEATURES += "wifi"

# GPU
MACHINE_FEATURES += "${@'gpu' if d.getVar('ACCEPT_EULA_'+d.getVar('MACHINE')) == '1' else ''}"
MACHINE_FEATURES += "${@'openvx' if d.getVar('ACCEPT_EULA_'+d.getVar('MACHINE')) == '1' else ''}"
MACHINE_FEATURES += "${@'opencl' if d.getVar('ACCEPT_EULA_'+d.getVar('MACHINE')) == '1' else ''}"
MACHINE_FEATURES += "${@'vulkan' if d.getVar('ACCEPT_EULA_'+d.getVar('MACHINE')) == '1' else ''}"

# M33
MACHINE_FEATURES += "m33copro"
# M0
MACHINE_FEATURES += "m0copro"

# Bluetooth
BLUETOOTH_LIST += "linux-firmware-addons-bcm43xx"
# Wifi
WIFI_LIST += "linux-firmware-addons-bcm43xx"

# ==========================================================================
# WIFI / BLUETOOTH
# ==========================================================================
# for stm32mp215f-dk, add a devicetree overlay to support on M2 connector a
# wifi/bluetooth combo
# add devicetree overlay on bootfs:
ST_DEVICE_OVERLAY_ADDONS = "dtbo-stm32mp21x"

# add "m2-wifi" configuration
UBOOT_EXTLINUX_TARGETS_EXTRA_CONFIG[stm32mp215f-dk] += "m2-bt-wifi"
UBOOT_EXTLINUX_TARGETS_EXTRA_CONFIG[stm32mp215f-dk-ca35tdcid-ostl] += "m2-bt-wifi"
# define 'm2-wifi' configuration as default configuration
#UBOOT_EXTLINUX_DEFAULT_LABEL:m2-bt-wifi = "m2-bt-wifi"
UBOOT_EXTLINUX_FDTOVERLAYS:m2-bt-wifi = "/devicetree/stm32mp215f-dk-m2-bcm43xx-2ae.dtbo"

# select which BCRM module to used 2Ae or 2BZ
FIRMWARE_STM32MP215F_DK_BRCM_MODULE_2AE = "0"
FIRMWARE_STM32MP215F_DK_BRCM_MODULE_2BZ = "1"
# ==========================================================================
# Configure A7 examples labels
# ==========================================================================
# add example for testing pcsi on stm32mp257f-ev1
LINUX_A35_EXAMPLES_DT:append:stm32mp2 = " ${@bb.utils.contains('EXTERNAL_DT_ENABLED', '1', 'stm32mp257f-ev1-psci-osi', '', d)} "
# add example for testing pcsi on stm32mp215f-dk
LINUX_A35_EXAMPLES_DT:append:stm32mp2 = " ${@bb.utils.contains('EXTERNAL_DT_ENABLED', '1', 'stm32mp215f-dk-psci-osi', '', d)} "

# ==========================================================================
# M33 Boards
# ==========================================================================
# Lists of boards/devicetree on which the m33 service MUST be started
M33_BOARDS_START_AT_STARTUP = "stm32mp257f-dk stm32mp257f-ev1"
M33_BOARDS_START_AT_STARTUP =+ "stm32mp235f-dk"
M33_BOARDS_START_AT_STARTUP =+ "${@bb.utils.contains('EXTERNAL_DT_ENABLED', '1', 'stm32mp257f-dk-ca35tdcid-ostl', '', d)}"
M33_BOARDS_START_AT_STARTUP =+ "${@bb.utils.contains('EXTERNAL_DT_ENABLED', '1', 'stm32mp257f-ev1-ca35tdcid-ostl', '', d)}"

# supported m33fw board:
#          stm32mp215f-dk
M33FW_BOARDS += "stm32mp215f-dk"
# project name on m33tdprojects-starter-stm32mp2 to build
# M33FW_FIRMWARE[config_m33fw_board] ?= "<project_path>,<project_name>
M33FW_FIRMWARE[stm32mp215f-dk] ?= "Projects/STM32MP215F-DK/Demonstrations/OpenAMP/OpenAMP_TTY_echo,OpenAMP_TTY_echo"
# Default project to used
M33FW_DEFAULT_FIRMWARE[stm32mp215f-dk] ?= ""
# Define tf-m platform path
M33FW_TFM_PLATFORM[stm32mp215f-dk] ?= "stm/stm32mp215f_dk"
# Define tf-m platform extra opts config
M33FW_TFM_OPTFLAGS[stm32mp215f-dk] ?= "-DTFM_PARTITION_PROTECTED_STORAGE=OFF -DTFM_PARTITION_PLATFORM=ON"

# supported m33fw board:
#          stm32mp235f-dk
M33FW_BOARDS += "stm32mp235f-dk"
# project name on m33tdprojects-starter-stm32mp2
# M33FW_FIRMWARE[config_m33fw_board] ?= "<project_path>,<project_name>
M33FW_FIRMWARE[stm32mp235f-dk] ?= "Projects/STM32MP235F-DK/Demonstrations/USBPD_DRP_UCSI,USBPD_DRP_UCSI"
# Default project to used
M33FW_DEFAULT_FIRMWARE[stm32mp235f-dk] ?= "USBPD_DRP_UCSI"
# Define tf-m platform path
M33FW_TFM_PLATFORM[stm32mp235f-dk] ?= "stm/stm32mp235f_dk"
# Define tf-m platform extra opts config
M33FW_TFM_OPTFLAGS[stm32mp235f-dk] ?= "-DTFM_PARTITION_PROTECTED_STORAGE=OFF"

# supported m33fw board:
#          stm32mp257f-dk
M33FW_BOARDS += "stm32mp257f-dk"
# project name on m33tdprojects-starter-stm32mp2
# M33FW_FIRMWARE[config_m33fw_board] ?= "<project_path>,<project_name>
M33FW_FIRMWARE[stm32mp257f-dk] ?= "Projects/STM32MP257F-DK/Demonstrations/USBPD_DRP_UCSI,USBPD_DRP_UCSI"
# Default project to used
M33FW_DEFAULT_FIRMWARE[stm32mp257f-dk] ?= "USBPD_DRP_UCSI"
# Define tf-m platform path
M33FW_TFM_PLATFORM[stm32mp257f-dk] ?= "stm/stm32mp257f_dk"
# Define tf-m platform extra opts config
M33FW_TFM_OPTFLAGS[stm32mp257f-dk] ?= "-DTFM_PARTITION_PROTECTED_STORAGE=OFF"

# supported m33fw board:
#          stm32mp257f-ev1
M33FW_BOARDS += "stm32mp257f-ev1"
# project name on m33tdprojects-starter-stm32mp2
# M33FW_FIRMWARE[config_m33fw_board] ?= "<project_path>,<project_name>
M33FW_FIRMWARE[stm32mp257f-ev1] ?= "\
    Projects/STM32MP257F-EV1/Demonstrations/USBPD_DRP_UCSI,USBPD_DRP_UCSI \
    Projects/STM32MP257F-EV1/Demonstrations/LowPower_SRAM_Demo,LowPower_SRAM_Demo \
    "
# Default project to used
M33FW_DEFAULT_FIRMWARE[stm32mp257f-ev1] ?= "USBPD_DRP_UCSI"
# Define tf-m platform path
M33FW_TFM_PLATFORM[stm32mp257f-ev1] ?= "stm/stm32mp257f_ev1"
# Define tf-m platform extra opts config
M33FW_TFM_OPTFLAGS[stm32mp257f-ev1] ?= "-DTEST_NS_PS=OFF"

# =========================================================================
# OPTEE
# =========================================================================
# For sdk generation, declare the default board configuration to use.
ST_OPTEE_EXPORT_TA_REF_BOARD:stm32mp2common = "stm32mp257f-dk.dts"
```
