## conf/machine/stm32mp2-m33td.conf
```bitbake
#@TYPE: Machine
#@NAME: stm32mp2-m33td
#@DESCRIPTION: Configuration for STM32MP2x boards for cm33tdcid
#@NEEDED_BSPLAYERS: layers/meta-openembedded/meta-oe layers/meta-openembedded/meta-python

# Define specific familly common machine name
MACHINEOVERRIDES =. "stm32mp2m33tdcommon:stm32mp2m33td:"
MACHINEOVERRIDES =. "stm32mp2common:stm32mp25common:stm32mp23common:stm32mp21common:"

include conf/machine/include/st-machine-common-stm32mp.inc
include conf/machine/include/st-machine-providers-stm32mp.inc

# =========================================================================
# Chip architecture
# =========================================================================
DEFAULTTUNE = "cortexa35"
include conf/machine/include/arm/armv8a/tune-cortexa35.inc

# =========================================================================
# boot scheme
# =========================================================================
BOOTSCHEME_LABELS = "optee"
BOOTSCHEME_LABELS += "fastboot"

# =========================================================================
# boot device
# =========================================================================
# Define the boot device supported
BOOTDEVICE_LABELS += "nor-sdcard"
BOOTDEVICE_LABELS += "nor-nor-sdcard"
BOOTDEVICE_LABELS += "nor-emmc"
BOOTDEVICE_LABELS += "emmc"
BOOTDEVICE_LABELS += "sdcard"

# =========================================================================
# Machine settings
# =========================================================================
# Define list of devicetree per supported storage
# NOR configured with only main boot partitions
EXTERNAL_DEVICETREE_NOR_mb = "stm32mp257f-ev1-cm33tdcid-ostl"
# NOR configured with only main and secondary boot partitions
EXTERNAL_DEVICETREE_NOR_mb_sb = "stm32mp257f-ev1-cm33tdcid-ostl"
EXTERNAL_DEVICETREE_SDCARD = "stm32mp257f-ev1-cm33tdcid-ostl"
EXTERNAL_DEVICETREE_SDCARD =+ "stm32mp257f-dk-cm33tdcid-ostl"
EXTERNAL_DEVICETREE_SDCARD =+ "stm32mp235f-dk-cm33tdcid-ostl"
EXTERNAL_DEVICETREE_SDCARD =+ "stm32mp215f-dk-cm33tdcid-ostl"
EXTERNAL_DEVICETREE_EMMC = "stm32mp257f-ev1-cm33tdcid-ostl"
EXTERNAL_DEVICETREE_EMMC =+ "stm32mp257f-dk-cm33tdcid-ostl"


STM32MP_DT_FILES_PROGRAMMER = ""
EXTERNAL_DEVICETREE_PROGRAMMER =  "stm32mp257f-ev1-cm33tdcid-ostl-serial-ca35tdcid"
EXTERNAL_DEVICETREE_PROGRAMMER =+ "stm32mp257f-dk-cm33tdcid-ostl-serial-ca35tdcid"
EXTERNAL_DEVICETREE_PROGRAMMER =+ "stm32mp235f-dk-cm33tdcid-ostl-serial-ca35tdcid"
EXTERNAL_DEVICETREE_PROGRAMMER =+ "stm32mp215f-dk-cm33tdcid-ostl-serial-ca35tdcid"

STM32MP_DEVICETREE_PROGRAMMER_ENABLE = "1"
STM32MP_DEVICETREE_PROGRAMMER_SUFFIX = "-serial-ca35tdcid"

# =========================================================================
# Machine features
# =========================================================================
# with M33 Starter app which manage to display the splashscreen, the functionality
# must be disabled to not enter on conflict between starter app and u-boot and userland
# MACHINE_FEATURES += "splashscreen"
MACHINE_FEATURES += "watchdog"
MACHINE_FEATURES += "bluetooth"
MACHINE_FEATURES += "wifi"

# GPU
MACHINE_FEATURES += "${@'gpu' if d.getVar('ACCEPT_EULA_'+d.getVar('MACHINE')) == '1' else ''}"
MACHINE_FEATURES += "${@'openvx' if d.getVar('ACCEPT_EULA_'+d.getVar('MACHINE')) == '1' else ''}"
MACHINE_FEATURES += "${@'opencl' if d.getVar('ACCEPT_EULA_'+d.getVar('MACHINE')) == '1' else ''}"
MACHINE_FEATURES += "${@'vulkan' if d.getVar('ACCEPT_EULA_'+d.getVar('MACHINE')) == '1' else ''}"

# M33TD
MACHINE_FEATURES += "m33td"

# Bluetooth
BLUETOOTH_LIST += "linux-firmware-addons-bcm43xx"
# Wifi
WIFI_LIST += "linux-firmware-addons-bcm43xx"

# Configure external dt suffix
EXTDT_USE_SUFFIX = "1"
EXTDT_SUFFIX_EMMC   = "-emmc"
EXTDT_SUFFIX_NOR    = "-snor"
EXTDT_SUFFIX_SDCARD = "-sdcard"

# ==========================================================================
# WIFI / BLUETOOTH
# ==========================================================================
# for stm32mp215f-dk, add a devicetree overlay to support on M2 connector a
# wifi/bluetooth combo
# add devicetree overlay on bootfs:
ST_DEVICE_OVERLAY_ADDONS = "dtbo-stm32mp21x"

# add "m2-wifi" configuration
# WARNING: with m33td and external-dt usage, you must add a rule to add dtb awith specific storage suffix
UBOOT_EXTLINUX_TARGETS_EXTRA_CONFIG:target-sdcard += "stm32mp215f-dk-cm33tdcid-ostl-sdcard"
UBOOT_EXTLINUX_TARGETS_EXTRA_CONFIG[stm32mp215f-dk-cm33tdcid-ostl-sdcard] += "m2-bt-wifi"
# define 'm2-wifi' configuration as default configuration
#UBOOT_EXTLINUX_DEFAULT_LABEL:m2-bt-wifi = "m2-bt-wifi"
UBOOT_EXTLINUX_FDTOVERLAYS:m2-bt-wifi = "/devicetree/stm32mp215f-dk-m2-bcm43xx-2ae.dtbo"

# =========================================================================
# OPTEE
# =========================================================================
# For sdk generation, declare the default board configuration to use.
ST_OPTEE_EXPORT_TA_REF_BOARD:stm32mp2common = "stm32mp257f-dk.dts"

# ==========================================================================
# M33 Firmware
# ==========================================================================
# Configure m33fw build configuration
M33FW_BUILDCONF += "full-dynamic"
M33FW_BUILDCONF += "full-static"
M33FW_BUILDCONF += "minimal"

# -----------------------------------------------
# Define config for each M33FW_BUILDCONF
M33FW_BUILDCONF[full-dynamic] ?= "-DBUILD_CONFIG=FULL -DBOOT_SPLASHSCREEN=DYNAMIC"
M33FW_BUILDCONF[full-static]  ?= "-DBUILD_CONFIG=FULL -DBOOT_SPLASHSCREEN=STATIC"
M33FW_BUILDCONF[minimal]  ?= "-DBUILD_CONFIG=MINIMUM"

# supported m33fw board:
#          stm32mp215f-dk
M33FW_BOARDS += "stm32mp215f-dk"
# project name on m33tdprojects-starter-stm32mp2 to build
# M33FW_FIRMWARE[config_m33fw_board] ?= "<project_path>,<project_name>,<buildconf_type>
M33FW_FIRMWARE[stm32mp215f-dk] ?= "\
    Projects/STM32MP215F-DK/Demonstrations/StarterApp_M33TD,StarterApp_M33TD,full-dynamic \
    Projects/STM32MP215F-DK/Demonstrations/StarterApp_M33TD,StarterApp_M33TD,full-static \
    Projects/STM32MP215F-DK/Demonstrations/StarterApp_M33TD,StarterApp_M33TD,minimal \
    "
# Default project to used
M33FW_DEFAULT_FIRMWARE[stm32mp215f-dk] ?= "StarterApp_M33TD_full-dynamic"
# Define tf-m platform path
M33FW_TFM_PLATFORM[stm32mp215f-dk] ?= "stm/stm32mp215f_dk"
# Define tf-m platform extra opts config
M33FW_TFM_OPTFLAGS[stm32mp215f-dk] ?= "-DTFM_PARTITION_PROTECTED_STORAGE=OFF -DTFM_PARTITION_PLATFORM=ON"

# supported m33fw board:
#          stm32mp235f-dk
M33FW_BOARDS += "stm32mp235f-dk"
# project name on m33tdprojects-starter-stm32mp2
# M33FW_FIRMWARE[config_m33fw_board] ?= "<project_path>,<buildconf_type>
M33FW_FIRMWARE[stm32mp235f-dk] ?= "\
    Projects/STM32MP235F-DK/Demonstrations/StarterApp_M33TD,StarterApp_M33TD,full-dynamic \
    Projects/STM32MP235F-DK/Demonstrations/StarterApp_M33TD,StarterApp_M33TD,full-static \
    Projects/STM32MP235F-DK/Demonstrations/StarterApp_M33TD,StarterApp_M33TD,minimal \
    "
# Default project to used
M33FW_DEFAULT_FIRMWARE[stm32mp235f-dk] ?= "StarterApp_M33TD_full-dynamic"
# Define tf-m platform path
M33FW_TFM_PLATFORM[stm32mp235f-dk] ?= "stm/stm32mp235f_dk"
# Define tf-m platform extra opts config
M33FW_TFM_OPTFLAGS[stm32mp235f-dk] ?= "-DTFM_PARTITION_PROTECTED_STORAGE=OFF"

# supported m33fw board:
#          stm32mp257f-dk
M33FW_BOARDS += "stm32mp257f-dk"
# project name on m33tdprojects-starter-stm32mp2
# M33FW_FIRMWARE[config_m33fw_board] ?= "<project_path>,<buildconf_type>
M33FW_FIRMWARE[stm32mp257f-dk] ?= "\
    Projects/STM32MP257F-DK/Demonstrations/StarterApp_M33TD,StarterApp_M33TD,full-dynamic \
    Projects/STM32MP257F-DK/Demonstrations/StarterApp_M33TD,StarterApp_M33TD,full-static \
    Projects/STM32MP257F-DK/Demonstrations/StarterApp_M33TD,StarterApp_M33TD,minimal \
    "
# Default project to used
M33FW_DEFAULT_FIRMWARE[stm32mp257f-dk] ?= "StarterApp_M33TD_full-dynamic"
# Define tf-m platform path
M33FW_TFM_PLATFORM[stm32mp257f-dk] ?= "stm/stm32mp257f_dk"
# Define tf-m platform extra opts config
M33FW_TFM_OPTFLAGS[stm32mp257f-dk] ?= "-DTFM_PARTITION_PROTECTED_STORAGE=OFF"

# supported m33fw board:
#          stm32mp257f-ev1
M33FW_BOARDS += "stm32mp257f-ev1"
# project name on m33tdprojects-starter-stm32mp2
# M33FW_FIRMWARE[config_m33fw_board] ?= "<project_path>,<buildconf_type>
M33FW_FIRMWARE[stm32mp257f-ev1] ?= "\
    Projects/STM32MP257F-EV1/Demonstrations/StarterApp_M33TD,StarterApp_M33TD,full-dynamic \
    Projects/STM32MP257F-EV1/Demonstrations/StarterApp_M33TD,StarterApp_M33TD,full-static \
    Projects/STM32MP257F-EV1/Demonstrations/StarterApp_M33TD,StarterApp_M33TD,minimal \
    "
# Default project to used
M33FW_DEFAULT_FIRMWARE[stm32mp257f-ev1] ?= "StarterApp_M33TD_full-dynamic"
# Define tf-m platform path
M33FW_TFM_PLATFORM[stm32mp257f-ev1] ?= "stm/stm32mp257f_ev1"
# Define tf-m platform extra opts config
M33FW_TFM_OPTFLAGS[stm32mp257f-ev1] ?= "-DTEST_NS_PS=OFF"
```
