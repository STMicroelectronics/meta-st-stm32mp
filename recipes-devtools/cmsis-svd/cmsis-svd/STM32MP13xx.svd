# STM32MP13xx register map
File version: 1.7
CPU: CA7 r0p0, little endian, MPU, FPU, 4 interrupt priority bits
Registers are 32-bit, read-write, reset 0x0 unless marked. A register's access mark holds for its fields unless they carry their own. Offsets are from the block's base; lines under a group give offsets from that group; [hi:lo] are bit positions; {n}, {i} and the like mark numbered series; 'fields as' and 'values as' point back to an identical list; <NAME> marks a mode.

## Memory map
0x40000000 TIM2 size 0x400
0x40001000 TIM3 size 0x400
0x40002000 TIM4 size 0x400
0x40003000 TIM5 size 0x400
0x40004000 TIM6 size 0x400
0x40005000 TIM7 size 0x400
0x40009000 LPTIM1 size 0x400 — LPTIM
0x4000B000 SPI2 size 0x400
0x4000C000 SPI3 size 0x400
0x4000D000 SPDIFRX size 0x400
0x4000F000 USART3 size 0x400
0x40010000 USART4 size 0x400
0x40011000 USART5 size 0x400
0x40012000 I2C1 size 0x400 — I2C
0x40013000 I2C2 size 0x400
0x40018000 USART7 size 0x400
0x40019000 USART8 size 0x400
0x44000000 TIM1 size 0x400 — TIM
0x44001000 TIM8 size 0x400 — TIM
0x44003000 USART6 size 0x400
0x44004000 SPI1 size 0x400
0x4400A000 SAI1 size 0x400 — SAI1 register block
0x4400B000 SAI2 size 0x400
0x4400D000 DFSDM size 0x800
0x4400E000 FDCAN1 size 0x400
0x4400F000 FDCAN2 size 0x400
0x44010000 CCU size 0x400
0x48000000 DMA1 size 0x400
0x48001000 DMA2 size 0x400
0x48002000 DMAMUX1 size 0x400
0x48003000 ADC1 size 0x400 — ADC
0x48004000 ADC2 size 0x400
0x48005000 DMA3 size 0x400
0x48006000 DMAMUX2 size 0x400
0x49000000 OTG size 0x40000
0x4C000000 USART1 size 0x400 — Universal synchronous asynchronous receiver transmitter
0x4C001000 USART2 size 0x400
0x4C002000 SPI4 size 0x400
0x4C003000 SPI5 size 0x400
0x4C004000 I2C3 size 0x400
0x4C005000 I2C4 size 0x400
0x4C006000 I2C5 size 0x400
0x4C007000 TIM12 size 0x400 — TIM register block
0x4C008000 TIM13 size 0x400 — TIM register block
0x4C009000 TIM14 size 0x400
0x4C00A000 TIM15 size 0x400
0x4C00B000 TIM16 size 0x400
0x4C00C000 TIM17 size 0x400
0x50000000 RCC size 0x1000
0x50001000 PWR size 0x400
0x50002000 GPIOA size 0x400
0x50003000 GPIOB size 0x400
0x50004000 GPIOC size 0x400
0x50005000 GPIOD size 0x400
0x50006000 GPIOE size 0x400
0x50007000 GPIOF size 0x400
0x50008000 GPIOG size 0x400
0x50009000 GPIOH size 0x400
0x5000A000 GPIOI size 0x400
0x5000B000 TSC size 0x400
0x5000D000 EXTI size 0x400
0x50020000 SYSCFG size 0x400
0x50021000 LPTIM2 size 0x400
0x50022000 LPTIM3 size 0x400
0x50023000 LPTIM4 size 0x400
0x50024000 LPTIM5 size 0x400
0x50025000 VREFBUF size 0x400
0x50028000 DTS size 0x400 — DTS register block
0x5002A000 HDP size 0x400 — HDP register block
0x50081000 DBGMCU size 0x1000 — Microcontroller Debug Unit
0x54002000 CRYP size 0x400
0x54003000 HASH size 0x400 — HASH register bank
0x54004000 RNG size 0x400
0x54005000 SAES size 0x400 — SAES register block
0x54006000 PKA size 0x2000
0x57000000 AXIMC size 0x100000
0x58000000 MDMA size 0x1000
0x58001000 MCE size 0x400
0x58002000 FMC size 0x1000 — FMC register block
0x58003000 QUADSPI size 0x1000 — QUADSPI1
0x58004000 DLYBQS size 0x1000
0x58005000 SDMMC size 0x400 — SDMMC address block description
0x58006000 DLYBSD1 size 0x1000 — DLYB
0x58007000 SDMMC2 size 0x400
0x58008000 DLYBSD2 size 0x1000
0x58009000 CRC size 0x1000
0x5800A000 ETH1 size 0x2000 — ETH
0x5800E000 ETH2 size 0x2000
0x5A000000 DCMIPP size 0x1000 — DCMIPP register block
0x5A001000 LTDC size 0x400 — LTDC register block
0x5A002000 IWDG2 size 0x400
0x5A003000 DDRCTRL size 0x1000
0x5A004000 DDRPHYC size 0x1000
0x5A005000 STGENR size 0x1000
0x5A006000 USBPHYC size 0x1000
0x5A007000 DDRPERFM size 0x400
0x5C003000 IWDG1 size 0x400
0x5C004000 RTC size 0x400
0x5C005000 BSEC size 0x1000
0x5C006000 TZC size 0x1000
0x5C007000 ETZPC size 0x400
0x5C008000 STGENC size 0x1000 — STGEN
0x5C00A000 TAMP size 0x400
0xA0021000 GICD size 0x1000 — GICD address block description
0xA0022000 GICC size 0x2000 — GICC address block description
0xA0024000 GICH size 0x2000 — GICH address block description
0xA0026000 GICV size 0x2000 — GICV address block description

## Interrupts
0 TSC — Touch sensor global interrupt
1 PVD_AVD (EXTI) — PVD AND AVD detector through EXTI
2 TAMP — Tamper interrupt (include LSECSS interrupts)
3 RTC_WKUP_ALARM (RTC) — RTC wakeup timer and alarms (A and B) interrupt
4 TZC_IT (TZC) — TrustZone DDR address space controller
5 RCC — RCC global interrupt
6 EXTI0 (EXTI) — EXTI Line 0 interrupt
7 EXTI1 (EXTI) — EXTI Line 1 interrupt
8 EXTI2 (EXTI) — EXTI Line 2 interrupt
9 EXTI3 (EXTI) — EXTI Line 3 interrupt
10 EXTI4 (EXTI) — EXTI Line 4 interrupt
11 DMA1_STR0 (DMA1) — DMA1 stream0 global interrupt
12 DMA1_STR1 (DMA1) — DMA1 stream1 global interrupt
13 DMA1_STR2 (DMA1) — DMA1 stream2 global interrupt
14 DMA1_STR3 (DMA1) — DMA1 stream3 global interrupt
15 DMA1_STR4 (DMA1) — DMA1 stream4 global interrupt
16 DMA1_STR5 (DMA1) — DMA1 stream5 global interrupt
17 DMA1_STR6 (DMA1) — DMA1 stream6 global interrupt
18 ADC1 — ADC1 global interrupt
19 ADC2 — ADC2 global interrupt
20 FDCAN1_IT0 (FDCAN1) — FDCAN1 interrupt 0
21 FDCAN2_IT0 (FDCAN2) — FDCAN2 interrupt 0
22 FDCAN1_IT1 (FDCAN1) — FDCAN1 interrupt 1
23 FDCAN2_IT1 (FDCAN2) — FDCAN2 interrupt 1
24 EXTI5 (EXTI) — EXTI line 5 interrupt
25 TIM1_BRK (TIM1) — TIM1 break interrupt
26 TIM1_UP (TIM1) — TIM1 update interrupt
27 TIM1_TRG_COM (TIM1) — TIM1 trigger and commutation interrupt
28 TIM1_CC (TIM1) — TIM1 capture compare interrupt
29 TIM2 — TIM2 global interrupt
30 TIM3 — TIM3 global interrupt
31 TIM4 — TIM4 global interrupt
32 I2C1_EVT (I2C1) — I2C1 event interrupt
33 I2C1_ERR (I2C1) — I2C1 global error interrupt
34 I2C2_EVT (I2C2) — I2C2 event interrupt
35 I2C2_ERR (I2C2) — I2C2 global error interrupt
36 SPI1 — SPI1 global interrupt
37 SPI2 — SPI2 global interrupt
38 USART1 — USART1 global interrupt
39 USART2 — USART2 global interrupt
40 USART3 — USART3 global interrupt
41 EXTI10 (EXTI) — EXTI line 10 interrupt
42 RTC_TS (RTC) — RTC timestamp interrupt
43 EXTI11 (EXTI) — EXTI line 11 interrupt
44 TIM8_BRK (TIM8) — TIM8 break interrupt
45 TIM8_UP (TIM8) — TIM8 update interrupt
46 TIM8_TRG_COM (TIM8) — TIM8 trigger and commutation interrupt
47 TIM8_CC (TIM8) — TIM8 capture compare interrupt
48 DMA1_STR7 (DMA1) — DMA1 stream7 global interrupt
49 FMC — FMC global interrupt
50 SDMMC1 (SDMMC) — SDMMC global interrup
51 TIM5 — TIM5 global interrupt
52 SPI3 — SPI3 global interrupt
53 USART4 — USART4 global interrupt
54 USART5 — USART5 global interrupt
55 TIM6 — TIM6 global interrupt
56 TIM7 — TIM7 global interrupt
57 DMA2_STR0 (DMA2) — DMA2 stream0 global interrupt
58 DMA2_STR1 (DMA2) — DMA2 stream1 global interrupt
59 DMA2_STR2 (DMA2) — DMA2 stream2 global interrupt
60 DMA2_STR3 (DMA2) — DMA2 stream3 global interrupt
61 DMA2_STR4 (DMA2) — DMA2 stream4 global interrupt
62 ETH1 — Ethernet 1 global interrupt
63 ETH1_WKUP (ETH1) — Ethernet 1 wakeup interrupt (PMT)
64 FDCAN_CAL (CCU) — FDCAN CCU interrupt
65 EXTI6 (EXTI) — EXTI line 6 interrupt
66 EXTI7 (EXTI) — EXTI line 7 interrupt
67 EXTI8 (EXTI) — EXTI line 8 interrupt
68 EXTI9 (EXTI) — EXTI line 9 interrupt
69 DMA2_STR5 (DMA2) — DMA2 stream5 global interrupt
70 DMA2_STR6 (DMA2) — DMA2 stream6 global interrupt
71 DMA2_STR7 (DMA2) — DMA2 stream7 global interrupt
72 USART6 — USART6 global interrupt
73 I2C3_EVT (I2C3) — I2C3 event interrupt
74 I2C3_ERR (I2C3) — I2C3 global error interrupt
77 EXTI12 (EXTI) — EXTI line 12 interrupt
78 EXTI13 (EXTI) — EXTI line 13 interrupt
80 CRYP — CRYP global interrupt
81 HASH — HASH interrupt
82 SAES — Secure AES global interrupt
83 USART7 — USART7 global interrupt
84 USART8 — USART8 global interrupt
85 SPI4 — SPI4 global interrupt
86 SPI5 — SPI5 global interrupt
87 SAI1 — SAI1 global interrupt
88 LTDC — LTCD global interrupt
90 SAI2 — SAI2 global interrupt
91 QUADSPI — QUADSPI global interrupt
92 LPTIM1 — LPTIMER1 global interrupt
93 I2C4_EVT (I2C4) — I2C4 event interrupt
94 I2C4_ERR (I2C4) — I2C4 global error interrupt
95 SPDIFRX — SPDIFRX global interrupt
96 OTG — USB On-The-Go global interrupt
97 ETH2 — Ethernet 2 global interrupt
98 ETH2_WKUP (ETH2) — Ethernet 2 wakeup interrupt (PMT)
99 DMAMUX1_OVR_REQ (DMAMUX1) — DMAMUX1 overrun interrupt
100 DMAMUX2_OVR_REQ (DMAMUX2) — DMAMUX2 overrun interrupt
101 TIM15 — TIM15 global interrupt
102 TIM16 — TIM16 global interrupt
103 TIM17 — TIM17 global interrupt
104 TIM12 — TIM12 gloabl interrupt
105 PKA — PKA interrupt
106 EXTI14 (EXTI) — EXTI line 14 interrupt
107 MDMA — MDMA global interrupt
108 SDMMC2 — SDMMC2 global interrupt
109 EXTI15 (EXTI) — EXTI line 15 interrupt
111 TIM13 — TIM13 global interrupt
112 TIM14 — TIM14 global interrupt
113 RNG — RNG interrupt
114 I2C5_EVT (I2C5) — I2C5 event interrupt
115 I2C5_ERR (I2C5) — I2C5 global error interrupt
116 LPTIM2 — LPTIMER2 global interrupt
117 LPTIM3 — LPTIMER3 global interrupt
118 LPTIM4 — LPTIMER4 global interrupt
119 LPTIM5 — LPTIMER5 global interrupt
122 RCC_WAKEUP (RCC) — RCC MPU wakeup interrupt
124 DTS — Digital temperature sensor interrupt
126 IWDG1_IT (IWDG1) — IWDG1 early wake
127 IWDG2_IT (IWDG2) — IWDG2 early wake
128 TAMP_S (TAMP) — TAMP tamper secure interrupt
129 RTC_WKUP_ALARM_S (RTC) — RTC wakeup timer and alarms (A and B) secure interrupt
130 RTC_TS_S (RTC) — RTC timestamp secure interrupt
137 DDRPERFM — DDR performance monitor interrupt
139 MCE — MCE interrupt
{n+142} DMA3_STR{n} (DMA3) (n=0..7) — DMA3 stream{n} global interrupt

## Notices in the file
Copyright (c) 2025 STMicroelectronics.
SPDX-License-Identifier: Apache-2.0
Licensed under the Apache License, Version 2.0 (the "License");
you may not use this file except in compliance with the License.
You may obtain a copy of the License at
http://www.apache.org/licenses/LICENSE-2.0
Unless required by applicable law or agreed to in writing, software
distributed under the License is distributed on an "AS IS" BASIS,
WITHOUT WARRANTIES OR CONDITIONS OF ANY KIND, either express or implied.
See the License for the specific language governing permissions and
limitations under the License.
