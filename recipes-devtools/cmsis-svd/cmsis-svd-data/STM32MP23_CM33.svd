# STM32MP23_CM33 register map
File version: 1.2
CPU: CM33 r0p1, little endian, MPU, FPU, vendor SysTick, 8 interrupt priority bits
Registers are 32-bit, read-write, reset 0x0 unless marked. A register's access mark holds for its fields unless they carry their own. Offsets are from the block's base; [hi:lo] are bit positions; {n}, {i} and the like mark numbered series.

## VDEC — VDEC address block description
Base 0x480D0000
Same registers: VDEC_S 0x580D0000
0x00 VDEC_SWREG0 ro reset 0x6E645000 — VDEC ID register
  [31:0] SWREG_FIELD — ID register (read only) (all format mode)
0x04 VDEC_SWREG1 — VDEC interrupt register decoder register
  [31:0] SWREG_FIELD — Interrupt register decoder (all format mode)
0x08 VDEC_SWREG2 reset 0x400 — VDEC device configuration decoder register
  [31:0] SWREG_FIELD — Device configuration register decoder (all format mode)
0x0C VDEC_SWREG3 — VDEC decoder control register 0, decmode, picture type
  [31:0] SWREG_FIELD — Decoder control register 0 (decmode, picture type) (all format mode)
0x10 VDEC_SWREG4 — VDEC decoder control register 1, picture parameters
  [31:0] SWREG_FIELD — Decoder control register 1 (picture parameters) (all format mode)
0x14 VDEC_SWREG5 — VDEC decoder control register 2, stream decoding table selects
  [31:0] SWREG_FIELD — Decoder control register 2 (stream decoding table selects) (all format mode)
0x18 VDEC_SWREG6 — VDEC decoder control register 3, stream buffer information
  [31:0] SWREG_FIELD — Decoder control register 3 (stream buffer information) (all format mode)
0x1C VDEC_SWREG7 — VDEC decoder control register 4, H264, VC-1, VP6 and progressive JPEG control
  [31:0] SWREG_FIELD — Decoder control register 4 (H264, VC-1, VP6, and progressive JPEG control) (all format mode)
0x20 VDEC_SWREG8 — VDEC decoder control register 5, H264, VC-1, VP6, progressive JPEG and RV control
  [31:0] SWREG_FIELD — Decoder control register 5 (H264, VC-1, VP6, Progressive JPEG and RV control) (all format mode)
0x24 VDEC_SWREG9 — VDEC decoder control register 6/base address for MB-control, RLC /VC-1 intensity control 0/VP6,VP7,VP8 ctrl-stream length/ RV pic slice amount
  [31:0] SWREG_FIELD — Decoder control register 6 / base address for MB-control (RLC) / VC-1 intensity control 0/ VP6,VP7,VP8 ctrl-stream length/ RV pic slice amount (all format mode)
0x28 VDEC_SWREG10 — VDEC base address for differential motion vector base address RLC-mode/H264 P initial fwd ref pic list register, 4-9/ VC-1 intensity control 1/VP7 and VP8 segmentation base register
  [31:0] SWREG_FIELD — Base address for differential motion vector base address (RLC-mode) /H264 P initial fwd ref pic list register (4-9)/ VC-1 intensity control 1/ VP7 and VP8 segmentation base register (all format mode)
0x2C VDEC_SWREG11 — VDEC decoder control register 7, VLC/base address for H.264 intra prediction 4x4/base address for MPEG-4 DC component, RLC / H264 P initial fwd ref pic list register, 10- 15/VC-1 intensity control 2 register
  [31:0] SWREG_FIELD — Decoder control register 7 (VLC) / base address for H.264 intra prediction 4x4 / base address for MPEG-4 DC component (RLC) / H264 P initial fwd ref pic list register (10-15) / VC-1 intensity control 2 (all format mode)
0x30 VDEC_SWREG12 — VDEC base address for RLC data, RLC/stream start address /decoded end addr register, VLC
  [31:0] SWREG_FIELD — Base address for RLC data (RLC) / stream start address/decoded end addr register (VLC) (all format mode)
0x34 VDEC_SWREG13 — VDEC base address for decoded picture/base address for JPEG decoder output luminance picture register
  [31:0] SWREG_FIELD — Base address for decoded picture / base address for JPEG decoder output luminance picture (all format mode)
0x38 VDEC_SWREG14 — VDEC base address for reference picture index 0/base address for JPEG decoder output chrominance picture register
  [31:0] SWREG_FIELD — Base address for reference picture index 0 / base address for JPEG decoder output chrominance picture (all format mode)
0x3C VDEC_SWREG15 — VDEC base address for reference picture index 1/JPEG control register
  [31:0] SWREG_FIELD — Base address for reference picture index 1 / JPEG control (all format mode)
0x40 VDEC_SWREG16 — VDEC base address for reference picture index 2/list of VLC code lengths in first JPEG AC table register
  [31:0] SWREG_FIELD — Base address for reference picture index 2 / List of VLC code lengths in first JPEG AC table (all format mode)
0x44 VDEC_SWREG17 — VDEC base address for reference picture index 3/list of VLC code lengths in first JPEG AC table register
  [31:0] SWREG_FIELD — Base address for reference picture index 3 / List of VLC code lengths in first JPEG AC table (all format mode)
0x48 VDEC_SWREG18 — VDEC base address for reference picture list of VLC code lengths in first JPEG AC table/VP8 golden refer picture base register
  [31:0] SWREG_FIELD — Base address for reference picture index 4 / List of VLC code lengths in first JPEG AC table / VP8 Golden refer picture base (all format mode)
0x4C VDEC_SWREG19 — VDEC base address for reference picture index 5/list of VLC code lengths in first/second JPEG AC table register
  [31:0] SWREG_FIELD — Base address for reference picture index 5 / List of VLC code lengths in first/second JPEG AC table
0x50 VDEC_SWREG20 — VDEC base address for reference picture index 6/list of VLC code lengths in second JPEG AC table register
  [31:0] SWREG_FIELD — Base address for reference picture index 6 / List of VLC code lengths in second JPEG AC table
0x54 VDEC_SWREG21 — VDEC base address for reference picture index 7/list of VLC code lengths in second JPEG AC table register
  [31:0] SWREG_FIELD — Base address for reference picture index 7 / List of VLC code lengths in second JPEG AC table
0x58 VDEC_SWREG22 — VDEC base address for reference picture index 8/list of VLC code lengths in second JPEG AC table/VP7,VP8 DCT stream 1 base register
  [31:0] SWREG_FIELD — Base address for reference picture index 8 / List of VLC code lengths in second JPEG AC table / VP8 DCT stream 1 base (all format mode)
0x5C VDEC_SWREG23 — VDEC base address for reference picture index 9/list of VLC code lengths in first JPEG DC table/VP6 scan maps/VP7,VP8 DCT stream 2 base register
  [31:0] SWREG_FIELD — Base address for reference picture index 9 / List of VLC code lengths in first JPEG DC table / VP6 scan maps / VP7,VP8 DCT stream 2 base (all format mode)
0x60 VDEC_SWREG24 — VDEC base address for reference picture index 10/list of VLC code lengths in first JPEG DC table/VP6 scan maps/VP7, VP8 DCT stream 3 base register
  [31:0] SWREG_FIELD — Base address for reference picture index 10 / List of VLC code lengths in first JPEG DC table / VP6 scan maps / VP7, VP8 DCT stream 3 base (all format mode)
0x64 VDEC_SWREG25 — VDEC base address for reference picture index 11/list of VLC code lengths in second JPEG DC table/VP6 scan maps/VP7,VP8 DCT stream 4 base register
  [31:0] SWREG_FIELD — Base address for reference picture index 11 / List of VLC code lengths in second JPEG DC table / VP6 scan maps / VP7,VP8 DCT stream 4 base (all format mode)
0x68 VDEC_SWREG26 — VDEC base address for reference picture index 12/list of VLC code lengths in second JPEG DC table/VP6 scan maps/VP7, VP8 DCT stream 5 base register
  [31:0] SWREG_FIELD — Base address for reference picture index 12 / List of VLC code lengths in second JPEG DC table / VP6 scan maps / VP7, VP8 DCT stream 5 base (all format mode)
0x6C VDEC_SWREG27 — VDEC base address for reference picture index 13/VC-1 bitpl mbctrl or VP6, VP7, VP8 ctrl stream base/progressive JPEG DC table register
  [31:0] SWREG_FIELD — Base address for reference picture index 13 / VC-1 bitpl mbctrl or VP6, VP7, VP8 ctrl stream base /Progressive JPEG DC table(all format mode)
0x70 VDEC_SWREG28 — VDEC base address for reference picture index 14/VP6 scan maps /progressive JPEG DC table/VP7, VP8 DCT stream 6 base register
  [31:0] SWREG_FIELD — Base address for reference picture index 14 / VP6 scan maps /Progressive JPEG DC table / VP7, VP8 DCT stream 6 base (all format mode)
0x74 VDEC_SWREG29 — VDEC base address for reference picture index 15/VP6 scan maps/ VP7, VP8 DCT stream 7 base register
  [31:0] SWREG_FIELD — Base address for reference picture index 15 / VP6 scan maps / VP7, VP8 DCT stream 7 base (all format mode)
0x78 VDEC_SWREG30 — VDEC reference picture numbers for index 0 and 1, H264 VLC /VP6 scan maps/VP7, VP8 loop filter mb level adjusts register
  [31:0] SWREG_FIELD — Reference picture numbers for index 0 and 1 (H264 VLC) / VP6 scan maps / VP7, VP8 loop filter mb level adjusts (all format mode)
0x7C VDEC_SWREG31 — VDEC reference picture numbers for index 2 and 3, H264 VLC/ VP6 scan maps/VP7, VP8 loop filter ref pic level adjusts register
  [31:0] SWREG_FIELD — Reference picture numbers for index 2 and 3 (H264 VLC) / VP6 scan maps / VP7, VP8 loop filter ref pic level adjusts (all format mode)
0x80 VDEC_SWREG32 — VDEC reference picture numbers for index 4 and 5, H264 VLC/ VP6 scan maps/VP7, VP8 loop filter levels register
  [31:0] SWREG_FIELD — Reference picture numbers for index 4 and 5 (H264 VLC) / VP6 scan maps / VP7, VP8 loop filter levels (all format mode)
0x84 VDEC_SWREG33 — VDEC reference picture numbers for index 6 and 7, H264 VLC /VP6 scan maps/VP7, VP8 quantization values register
  [31:0] SWREG_FIELD — Reference picture numbers for index 6 and 7 (H264 VLC) / VP6 scan maps / VP7, VP8 quantization values (all format mode)
0x88 VDEC_SWREG34 — VDEC reference picture numbers for index 8 and 9, H264 VLC /VP8 prediction filter taps register
  [31:0] SWREG_FIELD — Reference picture numbers for index 8 and 9 (H264 VLC) / VP8 prediction filter taps (all format mode)
0x8C VDEC_SWREG35 — VDEC reference picture numbers for index 10 and 11, H264 VLC /VP8 prediction filter taps register
  [31:0] SWREG_FIELD — Reference picture numbers for index 10 and 11 (H264 VLC) / VP8 prediction filter taps (all format mode)
0x90 VDEC_SWREG36 — VDEC reference picture numbers for index 12 and 13, H264 VLC/ VP8 prediction filter taps Register
  [31:0] SWREG_FIELD — Reference picture numbers for index 12 and 13 (H264 VLC) / VP8 prediction filter taps (all format mode)
0x94 VDEC_SWREG37 — VDEC reference picture numbers for index 14 and 15, H264 VLC /VP8 prediction filter taps register
  [31:0] SWREG_FIELD — Reference picture numbers for index 14 and 15 (H264 VLC) / VP8 prediction filter taps (all format mode)
0x98 VDEC_SWREG38 — VDEC reference picture long term flags, H264 VLC/ VP8 prediction filter taps register
  [31:0] SWREG_FIELD — Reference picture long term flags (H264 VLC) / VP8 prediction filter taps (all format mode)
0x9C VDEC_SWREG39 — VDEC reference picture valid flags, H264 VLC/ VP8 prediction filter taps register
  [31:0] SWREG_FIELD — Reference picture valid flags (H264 VLC) / VP8 prediction filter taps (all format mode)
0xA0 VDEC_SWREG40 — VDEC base address for standard dependent table register
  [31:0] SWREG_FIELD — Base address for standard dependent tables (all format mode)
0xA4 VDEC_SWREG41 — VDEC base address for direct mode motion vectors/ progressive JPEG AC/DC coefficient read/write base register
  [31:0] SWREG_FIELD — Base address for direct mode motion vectors/Progressive JPEG AC/DC coefficient read/write base (all format mode)
0xA8 VDEC_SWREG42 — VDEC bi_dir initial ref pic list register, 0-2/VP6 prediction filter taps/progressive JPEG Cb ACDC coefficient base register
  [31:0] SWREG_FIELD — bi_dir initial ref pic list register (0-2) / VP6 prediction filter taps / Progressive JPEG Cb ACDC coefficient base (all format mode)
0xAC VDEC_SWREG43 — VDEC bi-dir initial ref pic list register, 3-5/VP6 prediction filter taps/progressive JPEG Cr ACDC coefficient base register
  [31:0] SWREG_FIELD — Bi-dir initial ref pic list register (3-5)/VP6 prediction filter taps / Progressive JPEG Cr ACDC coefficient base (all format mode)
0xB0 VDEC_SWREG44 — VDEC bi-dir initial ref pic list register, 6-8/VP6 prediction filter taps register
  [31:0] SWREG_FIELD — Bi-dir initial ref pic list register (6-8) / VP6 prediction filter taps (all format mode)
0xB4 VDEC_SWREG45 — VDEC bi-dir initial ref pic list register, 9-11/VP6 prediction filter taps register
  [31:0] SWREG_FIELD — Bi-dir initial ref pic list register (9-11) / VP6 prediction filter taps (all format mode)
0xB8 VDEC_SWREG46 — VDEC bi-dir initial ref pic list register, 12-14/VP7,VP8 quantization values register
  [31:0] SWREG_FIELD — Bi-dir initial ref pic list register (12-14) / VP7,VP8 quantization values (all format mode)
0xBC VDEC_SWREG47 — VDEC bi-dir and P fwd initial ref pic list register, 15 and P 0-3/ VP7,VP8 quantization values register
  [31:0] SWREG_FIELD — Bi-dir and P fwd initial ref pic list register (15 and P 0-3) / VP7,VP8 quantization values (all format mode)
0xC0 VDEC_SWREG48 — VDEC error concealment register
  [31:0] SWREG_FIELD — Error concealment register (all format mode)
0xC4 VDEC_SWREG49 — VDEC prediction filter tap register for H264
  [31:0] SWREG_FIELD — Prediction filter tap register for H264
0xC8 VDEC_SWREG50 ro reset 0x1334A780 — VDEC synthesis configuration register decoder 0
  [31:0] SWREG_FIELD — Synthesis configuration register decoder 0 (read only) (all format mode)
0xCC VDEC_SWREG51 — VDEC reference picture buffer control register
  [31:0] SWREG_FIELD — Reference picture buffer control register (all format mode)
0xD8 VDEC_SWREG54 ro reset 0xC09C0C00 — VDEC synthesis configuration register decoder 1
  [31:0] SWREG_FIELD — Synthesis configuration register decoder 1 (read only) (all format mode)
0xDC VDEC_SWREG55 — VDEC reference picture buffer 2/advanced prefetch control register
  [31:0] SWREG_FIELD — Reference picture buffer 2 / Advanced prefetch control register (all format mode)
0xE8 VDEC_SWREG58 — VDEC device configuration register decoder 2/multicore control register
  [31:0] SWREG_FIELD — Device configuration register decoder 2 + Multi core control register (all format mode)
0xEC VDEC_SWREG59 — VDEC H264 chrominance 8 pixel interleaved data base register
  [31:0] SWREG_FIELD — H264 Chrominance 8 pixel interleaved data base (all format mode)
0x198 VDEC_SWREG102 — VDEC base address for H264 and AVS decoded chroma picture register
  [31:0] SWREG_FIELD — Base address for H264 and AVS decoded chroma picture(all format mode)
{0x0+4i} VDEC_SWREG{i} (i=103..118) — VDEC base address for reference chroma picture index {i-103} register
  [31:0] SWREG_FIELD — Base address for reference chroma picture index {i-103} (all format mode)
