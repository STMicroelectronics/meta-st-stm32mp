# STM32MP25_CM33 register map
File version: 1.3
CPU: CM33 r0p1, little endian, MPU, FPU, vendor SysTick, 8 interrupt priority bits
Registers are 32-bit, read-write, reset 0x0 unless marked. A register's access mark holds for its fields unless they carry their own. Offsets are from the block's base; [hi:lo] are bit positions; {n}, {i} and the like mark numbered series; 'fields as' and 'values as' point back to an identical list.

## VENC — VENC address block description
Base 0x480E0000
Same registers: VENC_S 0x580E0000
0x00 VENC_SWREG0 reset 0x6E655000 — VENC ID register
  [31:0] SWREG_FIELD — Identification register (all format mode)
0x04 VENC_SWREG1 — VENC interrupt register
  [31:0] SWREG_FIELD — Interrupt register (all format mode)
0x08 VENC_SWREG2 reset 0x10 — VENC bus interface configuration register
  [31:0] SWREG_FIELD — Bus interface configuration register (all format mode)
0x0C VENC_SWREG3 — VENC device configuration register
  [31:0] SWREG_FIELD — Device configuration register (all format mode)
0x14 VENC_SWREG5 — VENC base address for output stream data register
  [31:0] SWREG_FIELD — Base address for output stream data (all format mode)
0x18 VENC_SWREG6 — VENC base address for output control data register
  [31:0] SWREG_FIELD — Base address for output control data (all format mode)
0x1C VENC_SWREG7 — VENC base address for reference luma register
  [31:0] SWREG_FIELD — Base address for reference luma (all format mode)
0x20 VENC_SWREG8 — VENC base address for reference chroma register
  [31:0] SWREG_FIELD — Base address for reference chroma (all format mode)
0x24 VENC_SWREG9 — VENC base address for reconstructed luma register
  [31:0] SWREG_FIELD — Base address for reconstructed luma (all format mode)
0x28 VENC_SWREG10 — VENC base address for reconstructed chroma register
  [31:0] SWREG_FIELD — Base address for reconstructed chroma (all format mode)
0x2C VENC_SWREG11 — VENC base address for input picture luma register
  [31:0] SWREG_FIELD — Base address for input picture luma (all format mode)
0x30 VENC_SWREG12 — VENC base address for input picture cb register
  [31:0] SWREG_FIELD — Base address for input picture cb (all format mode)
0x34 VENC_SWREG13 — VENC base address for input picture cr register
  [31:0] SWREG_FIELD — Base address for input picture cr (all format mode)
0x38 VENC_SWREG14 — VENC encoder control register 0
  [31:0] SWREG_FIELD — Encoder control register 0 (such as picture information or encoding mode) (all format mode)
0x3C VENC_SWREG15 — VENC encoder control register 1
  [31:0] SWREG_FIELD — Encoder control register 1 (such as preprocessing control, crop, rotate, input format) (all format mode)
0x40 VENC_SWREG16 — VENC encoder control register 2
  [31:0] SWREG_FIELD — Base address for second reference luma (H264 control) (all format mode)
0x44 VENC_SWREG17 — VENC encoder control register 3
  [31:0] SWREG_FIELD — Base address for second reference chroma (H264 control) (all format mode)
0x48 VENC_SWREG18 — VENC encoder control register 4
  [31:0] SWREG_FIELD — Encoder control register 4 (deblock filter mode, H264 control) (all format mode)
0x4C VENC_SWREG19 — VENC encoder control register 5
  [31:0] SWREG_FIELD — Encoder control register 5 (input format, motion vector etc) (all format mode)
0x50 VENC_SWREG20 — VENC encoder control register 6
  [31:0] SWREG_FIELD — Control of data JPEG or VP8 (all format mode)
0x54 VENC_SWREG21 — VENC encoder control register 7
  [31:0] SWREG_FIELD — Control of H264 or VP8 (all format mode)
0x58 VENC_SWREG22 — VENC stream header remainder MSB bits register
  [31:0] SWREG_FIELD — Stream header remainder bits MSB (MSB aligned) (all format mode)
0x5C VENC_SWREG23 — VENC stream header remainder LSB bits register
  [31:0] SWREG_FIELD — Stream header remainder bits LSB (MSB aligned) (all format mode)
0x60 VENC_SWREG24 — VENC stream buffer limit/output stream size register
  [31:0] SWREG_FIELD — Stream buffer limit (64-bit addresses)/output stream size (bits) (allformat mode)
0x64 VENC_SWREG25 — VENC encoder control register 8
  [31:0] SWREG_FIELD — Control of MAD control and QP sum output (all format mode)
0x68 VENC_SWREG26 — VENC intra-slice bitmap/base address for VP8 counters register
  [31:0] SWREG_FIELD — intra-slice bitmap/base address for VP8 counters for probability updates (all format mode)
0x6C VENC_SWREG27 — VENC encoder control register 9
  [31:0] SWREG_FIELD — Control of H264 QP and VP8 QPY1 (all format mode)
0x70 VENC_SWREG28 — VENC encoder control register 10
  [31:0] SWREG_FIELD — H264 checkpoint 1-2 and VP8 QPY1 (all format mode)
0x74 VENC_SWREG29 — VENC encoder control register 11
  [31:0] SWREG_FIELD — H.264 Checkpoint 3 -4 and VP8 QPY2 (all format mode)
0x78 VENC_SWREG30 — VENC encoder control register 12
  [31:0] SWREG_FIELD — H.264 checkpoint 5 -6 and VP8 QPY2 (all format mode)
0x7C VENC_SWREG31 — VENC encoder control register 13
  [31:0] SWREG_FIELD — H.264 checkpoint 7 -8 and VP8 QPCh (all format mode)
0x80 VENC_SWREG32 — VENC encoder control register 14
  [31:0] SWREG_FIELD — H.264 Checkpoint 8 -10 / Encoder control register 14 (VP8 QPCh) (all format mode)
0x84 VENC_SWREG33 — VENC encoder control register 15
  [31:0] SWREG_FIELD — H.264 Checkpoint word error 1-2 and mvRefIdx/VP8 QPY1 (allformatmode)
0x88 VENC_SWREG34 — VENC encoder control register 16
  [31:0] SWREG_FIELD — H.264 checkpoint word error 3-4 and the second reference frame control (all format mode)
0x8C VENC_SWREG35 — VENC H.264 checkpoint word error 5-6/encoder control register 17
  [31:0] SWREG_FIELD — H.264 Checkpoint word error 5-6 / Encoder control register 17 (all format mode)
0x90 VENC_SWREG36 — VENC H.264 checkpoint delta QP 1-8/encoder control register 18
  [31:0] SWREG_FIELD — H.264 Checkpoint delta QP 1-8 / Encoder control register 18 (LongTermPenalty VP8 Filter) (all format mode)
0x94 VENC_SWREG37 — VENC encoder control register 19, VP8 filter, stream start offset
  [31:0] SWREG_FIELD — Encoder control register 19 (VP8 filter, stream start offset) (all format mode)
0x98 VENC_SWREG38 — VENC macroblock count output register
  [31:0] SWREG_FIELD — Macroblock count output (all format mode)
0x9C VENC_SWREG39 — VENC base address for next pic luminance register
  [31:0] SWREG_FIELD — Base address for next pic luminance (all format mode)
0xA0 VENC_SWREG40 — VENC stabilization mode control register
  [31:0] SWREG_FIELD — Stabilization mode control (all format mode)
0xA4 VENC_SWREG41 — VENC stabilization motion sum div8 output register
  [31:0] SWREG_FIELD — Stabilization motion sum div8 output (all format mode)
0xA8 VENC_SWREG42 — VENC stabilization GMV output, matrix 1, up-left position output register
  [31:0] SWREG_FIELD — Stabilization GMV output, matrix 1 (up-left position) output (all format mode)
0xAC VENC_SWREG43 — VENC stabilization GMV output, matrix 2, up position output register
  [31:0] SWREG_FIELD — Stabilization GMV output, matrix 2 (up position) output (all format mode)
0xB0 VENC_SWREG44 — VENC stabilization matrix 3, up-right position output register
  [31:0] SWREG_FIELD — Stabilization matrix 3 (up-right position) output (all format mode)
0xB4 VENC_SWREG45 — VENC stabilization matrix 4, left position output register
  [31:0] SWREG_FIELD — Stabilization matrix 4 (left position) output (all format mode)
0xB8 VENC_SWREG46 — VENC stabilization matrix 5, GMV position output register
  [31:0] SWREG_FIELD — Stabilization matrix 5 (GMV position) output (all format mode)
0xBC VENC_SWREG47 — VENC stabilization matrix 6, right position output register
  [31:0] SWREG_FIELD — Stabilization matrix 6 (right position) output (all format mode)
0xC0 VENC_SWREG48 — VENC stabilization matrix 7, down-left position output register
  [31:0] SWREG_FIELD — Stabilization matrix 7 (down-left position) output (all format mode)
0xC4 VENC_SWREG49 — VENC stabilization matrix 8, down position output register
  [31:0] SWREG_FIELD — Stabilization matrix 8 (down position) output (all format mode)
0xC8 VENC_SWREG50 — VENC stabilization matrix 9, down-right position output register
  [31:0] SWREG_FIELD — Stabilization matrix 9 (down-right position) output (all format mode)
0xCC VENC_SWREG51 — VENC base address for cabac context tables H264 or probability tables VP8 register
  [31:0] SWREG_FIELD — Base address for cabac context tables (H264) or probability tables (VP8) (all format mode)
0xD0 VENC_SWREG52 — VENC base address for MV output writing register
  [31:0] SWREG_FIELD — Base address for MV output writing (all format mode)
0xD4 VENC_SWREG53 — VENC RGB to YUV conversion coefficient A - B register
  [31:0] SWREG_FIELD — RGB to YUV conversion coefficient A - B (all format mode)
0xD8 VENC_SWREG54 — VENC RGB to YUV conversion coefficient C - E register
  [31:0] SWREG_FIELD — RGB to YUV conversion coefficient C - E (all format mode)
0xDC VENC_SWREG55 — VENC RGB to YUV conversion coefficient F, RGB mask MSB bit position register
  [31:0] SWREG_FIELD — RGB to YUV conversion coefficient F, RGB mask MSB bit position (all format mode)
0xE0 VENC_SWREG56 — VENC intra area register
  [31:0] SWREG_FIELD — intra area (all format mode)
0xE4 VENC_SWREG57 — VENC CIR intra mb position register
  [31:0] SWREG_FIELD — CIR intra mb position (all format mode)
0xE8 VENC_SWREG58 — VENC intra slice bitmap for slices 0..31/base address for VP8 1st DCT partition register
  [31:0] SWREG_FIELD — intra slice bitmap for slices 0..31 / Base address for VP8 1st DCT partition (all format mode)
0xEC VENC_SWREG59 — VENC intra slice bitmap for slices 32..63/base address for VP8 2nd DCT partition register
  [31:0] SWREG_FIELD — intra slice bitmap for slices 32..63 / Base address for VP8 2nd DCT partition (all format mode)
0xF0 VENC_SWREG60 — VENC 1st ROI area register
  [31:0] SWREG_FIELD — 1st ROI area (all format mode)
0xF4 VENC_SWREG61 — VENC 2nd ROI area register
  [31:0] SWREG_FIELD — 2nd ROI area (all format mode)
0xF8 VENC_SWREG62 — VENC ROI area delta QP, MV register
  [31:0] SWREG_FIELD — ROI area delta QP, MV (all format mode)
0xFC VENC_SWREG63 ro reset 0x1A622780 — VENC synthesis configuration register encoder 0 register
  [31:0] SWREG_FIELD — Synthesis configuration register encoder 0 (read only) (all format mode)
0x100 VENC_SWREG64 — VENC JPEG luma quantization 1/VP8 intra 16x16 mode 0-1 penalty register
  [31:0] SWREG_FIELD — JPEG luma quantization 1 / VP8 intra 16x16 mode 0-1 penalty (all format mode)
0x104 VENC_SWREG65 — VENC JPEG luma quantization 2/VP8 intra 16x16 mode 2-3 penalty register
  [31:0] SWREG_FIELD — JPEG luma quantization 2 / VP8 intra 16x16 mode 2-3 penalty (all format mode)
{0x0+4i} VENC_SWREG{i} (i=66..70) — VENC JPEG luma quantization {i-63}/VP8 intra 4x4 mode {2i-132}-{2i-131} penalty register
  [31:0] SWREG_FIELD — JPEG luma quantization {i-63} / VP8 intra 4x4 mode {2i-132}-{2i-131} penalty (all format mode)
0x11C VENC_SWREG71 — VENC JPEG luma quantization 8/base address for VP8 segmentation map register
  [31:0] SWREG_FIELD — JPEG luma quantization 8 / Base address for VP8 segmentation map (all format mode)
{0x0+4i} VENC_SWREG{i} (i=72..78) — VENC JPEG luma quantization {i-63}/VP8 segment1 parameter register
  [31:0] SWREG_FIELD — JPEG luma quantization {i-63} / VP8 segment1 parameter (all format mode)
0x13C VENC_SWREG79 — VENC JPEG luma quantization 16/VP8 segment2 parameter register
  [31:0] SWREG_FIELD — JPEG luma quantization 16 / VP8 segment2 parameter (all format mode)
{0x0+4i} VENC_SWREG{i} (i=80..87) — VENC JPEG chroma quantization {i-79}/VP8 segment2 parameter register
  [31:0] SWREG_FIELD — JPEG chroma quantization {i-79} / VP8 segment2 parameter (all format mode)
{0x0+4i} VENC_SWREG{i} (i=88..95) — VENC JPEG chroma quantization {i-79}/VP8 segment3 parameter register
  [31:0] SWREG_FIELD — JPEG chroma quantization {i-79} / VP8 segment3 parameter (all format mode)
0x180 VENC_SWREG96 wo — VENC DMV 4p/1p penalty values 0-3 register
  [31:0] SWREG_FIELD — DMV 4p/1p penalty values 0-3 (all format mode)
0x184 VENC_SWREG97 wo — VENC DMV 4p/1p penalty values 4-7 register
  [31:0] SWREG_FIELD — DMV 4p/1p penalty values 4-7 (all format mode)
{0x0+4i} VENC_SWREG{i} wo (i=98..126) — VENC DMV 4p/1p penalty values register
  [31:0] SWREG_FIELD — DMV 4p/1p penalty values (all format mode)
0x1FC VENC_SWREG127 wo — VENC DMV 4p/1p penalty values 124-127 register
  [31:0] SWREG_FIELD — DMV 4p/1p penalty values 124-127 (all format mode)
0x200 VENC_SWREG128 wo — VENC DMV qpel penalty values 0-3 register
  [31:0] SWREG_FIELD — DMV qpel penalty values 0-3 (all format mode)
0x204 VENC_SWREG129 wo — VENC DMV qpel penalty values 4-7 register
  [31:0] SWREG_FIELD — DMV qpel penalty values 4-7 (all format mode)
{0x0+4i} VENC_SWREG{i} wo (i=130..158) — VENC DMV qpel penalty values register
  [31:0] SWREG_FIELD — DMV qpel penalty values (all format mode)
0x27C VENC_SWREG159 wo — VENC DMV qpel penalty values 124-127 register
  [31:0] SWREG_FIELD — DMV qpel penalty values 124-127 (all format mode)
0x280 VENC_SWREG160 — VENC VP8 bit cost of inter type, coeff for dmv penalty register
  [31:0] SWREG_FIELD — VP8 bit cost of inter type, coeff for dmv penalty etc (all format mode)
0x284 VENC_SWREG161 — VENC VP8 bit cost of golden ref frame register
  [31:0] SWREG_FIELD — VP8 bit cost of golden ref frame (not used) (all format mode)
0x288 VENC_SWREG162 — VENC VP8 loop filter delta register
  [31:0] SWREG_FIELD — VP8 loop filter delta (all format mode)
0x28C VENC_SWREG163 — VENC VP8 loop filter delta register
  [31:0] SWREG_FIELD — VP8 loop filter delta (all format mode)
{0x0+4i} VENC_SWREG{i} (i=164..227) — VENC VP8 deadzone lookup table register
  [31:0] SWREG_FIELD — VP8 deadzone lookup table (all format mode)
0x390 VENC_SWREG228 — VENC VP8 deadzone rate multiplier for plane 0-1 register
  [31:0] SWREG_FIELD — VP8 deadzone rate multiplier for plane 0-1 (all format mode)
0x394 VENC_SWREG229 — VENC VP8 deadzone rate multiplier for plane 2-3 register
  [31:0] SWREG_FIELD — VP8 deadzone rate multiplier for plane 2-3 (all format mode)
0x398 VENC_SWREG230 — VENC VP8 deadzone rate for macroblock skip token 0-1 register
  [31:0] SWREG_FIELD — VP8 deadzone rate for macroblock skip token 0-1 (all format mode)
0x39C VENC_SWREG231 — VENC base address for output of down-scaled encoder image in YUYV 4:2:2 format register
  [31:0] SWREG_FIELD — Base address for output of down-scaled encoder image in YUYV 4:2:2 format (all format mode)
0x3A0 VENC_SWREG232 — VENC scaling control register
  [31:0] SWREG_FIELD — Scaling control (all format mode)
0x3A4 VENC_SWREG233 — VENC scaling control register
  [31:0] SWREG_FIELD — Scaling control (all format mode)
0x3B0 VENC_SWREG236 — VENC squared error output calculated for 13x13 pixels per macroblock register
  [31:0] SWREG_FIELD — Squared error output calculated for 13x13 pixels per macroblock (all format mode)
0x3B4 VENC_SWREG237 — VENC MAD 2 control and output register
  [31:0] SWREG_FIELD — MAD 2 control and output (all format mode)
0x3B8 VENC_SWREG238 — VENC MAD 3 control and output register
  [31:0] SWREG_FIELD — MAD 3 control and output (all format mode)
0x3BC VENC_SWREG239 — VENC VP8 predictor interpolation coefficient for full pixel position register
  [31:0] SWREG_FIELD — VP8 predictor interpolation coefficient for full pixel position (all format mode)
{0x0+4i} VENC_SWREG{i} (i=240..243) — VENC VP8 predictor interpolation coefficient for {i-239}/8 pixel position register
  [31:0] SWREG_FIELD — VP8 predictor interpolation coefficient for {i-239}/8 pixel position (all format mode)
0x3D0 VENC_SWREG244 — VENC base address for VP8 3rd DCT partition register
  [31:0] SWREG_FIELD — Base address for VP8 3rd DCT partition (all format mode)
0x3D4 VENC_SWREG245 — VENC base address for VP8 4th DCT partition register
  [31:0] SWREG_FIELD — Base address for VP8 4th DCT partition (all format mode)
0x400 VENC_SWREG256 — VENC segment 1: intra 16x16 mode 0-2 penalty register
  [31:0] SWREG_FIELD — segment 1: intra 16x16 mode 0-2 penalty (all format mode)
0x404 VENC_SWREG257 — VENC segment 1: intra 16x16 mode 3, intra 4x4 0-1 penalty register
  [31:0] SWREG_FIELD — segment 1: intra 16x16 mode 3 and intra 4x4 0-1 penalty (all format mode)
0x408 VENC_SWREG258 — VENC segment 1: intra 4x4 mode 2-4 penalty register
  [31:0] SWREG_FIELD — segment 1: intra 4x4 mode 2-4 penalty (all format mode)
0x40C VENC_SWREG259 — VENC segment 1: intra 4x4 mode 5-7 penalty register
  [31:0] SWREG_FIELD — segment 1: intra 4x4 mode 5-7 penalty (all format mode)
0x410 VENC_SWREG260 — VENC segment 1: intra 4x4 mode 8-9 penalty, previous mode favor for H.264 register
  [31:0] SWREG_FIELD — segment 1: intra 4x4 mode 8-9 penalty, previous mode favor for H.264 (all format mode)
0x414 VENC_SWREG261 — VENC segment 1: bit cost of inter type, intra 16x16 mode favor register
  [31:0] SWREG_FIELD — segment 1: Bit cost of inter type, intra 16x16 mode favor (all format mode)
0x418 VENC_SWREG262 — VENC segment 1: inter MB mode favor, skip mode penalty, penalty value for 2nd reference frame register
  [31:0] SWREG_FIELD — segment 1: inter MB mode favor, skip mode penalty, penalty value for second reference frame (all format mode)
0x41C VENC_SWREG263 — VENC segment 1: penalty value register
  [31:0] SWREG_FIELD — segment 1: penalty value (all format mode)
0x420 VENC_SWREG264 — VENC segment 1: penalty value register
  [31:0] SWREG_FIELD — segment 1: penalty value (all format mode)
0x424 VENC_SWREG265 — VENC segment 1: deadzone rate multiplier for plane 0-1 register
  [31:0] SWREG_FIELD — segment 1: Deadzone rate multiplier for plane 0-1 (all format mode)
0x428 VENC_SWREG266 — VENC segment 1: deadzone rate multiplier for plane 2-3 register
  [31:0] SWREG_FIELD — segment 1: Deadzone rate multiplier for plane 2-3 (all format mode)
0x42C VENC_SWREG267 — VENC segment 1: deadzone rate for macroblock skip token 0-1, dmv penalty coefficient register
  [31:0] SWREG_FIELD — segment 1: Deadzone rate for macroblock skip token 0-1, dmv penalty coefficient (all format mode)
0x430 VENC_SWREG268 — VENC segment 2: intra 16x16 mode 0-2 penalty register
  [31:0] SWREG_FIELD — segment 2: intra 16x16 mode 0-2 penalty (all format mode)
0x434 VENC_SWREG269 — VENC segment 2: intra 16x16 mode 3 penalty, intra 4x4 mode 0-1 penalty register
  [31:0] SWREG_FIELD — segment 2: intra 16x16 mode 3 penalty, intra 4x4 mode 0-1 penalty (all format mode)
0x438 VENC_SWREG270 — VENC segment 2: intra 4x4 mode 2-4 penalty register
  [31:0] SWREG_FIELD — segment 2: intra 4x4 mode 2-4 penalty (all format mode)
0x43C VENC_SWREG271 — VENC segment 2: intra 4x4 mode 5-7 penalty register
  [31:0] SWREG_FIELD — segment 2: intra 4x4 mode 5-7 penalty (all format mode)
0x440 VENC_SWREG272 — VENC segment 2: intra 4x4 mode 8-9 penalty, intra 4x4 previous mode favor for H.264 register
  [31:0] SWREG_FIELD — segment 2: intra 4x4 mode 8-9 penalty, intra 4x4 previous mode favor for H.264 (all format mode)
0x444 VENC_SWREG273 — VENC segment 2: bit cost of inter type, intra 16x16 mode favor register
  [31:0] SWREG_FIELD — segment 2: Bit cost of inter type, intra 16x16 mode favor (all format mode)
0x448 VENC_SWREG274 — VENC segment 2: inter MB mode favor, skip mode penalty, penalty value register
  [31:0] SWREG_FIELD — segment 2: inter MB mode favor, skip mode penalty, panelty value (all format mode)
0x44C VENC_SWREG275 — VENC segment 2: penalty value register
  [31:0] SWREG_FIELD — segment 2: penalty value (all format mode)
0x450 VENC_SWREG276 — VENC segment 2: penalty value register
  [31:0] SWREG_FIELD — segment 2: penalty value (all format mode)
0x454 VENC_SWREG277 — VENC segment 2: deadzone rate multiplier for plane 0-1 register
  [31:0] SWREG_FIELD — segment 2: Deadzone rate multiplier for plane 0-1 (all format mode)
0x458 VENC_SWREG278 — VENC segment 2: deadzone rate multiplier for plane 2-3 register
  [31:0] SWREG_FIELD — segment 2: Deadzone rate multiplier for plane 2-3 (all format mode)
0x45C VENC_SWREG279 — VENC segment 2: deadzone rate for macroblock skip token 0-1, dmv penalty coefficient register
  [31:0] SWREG_FIELD — segment 2: Deadzone rate for macroblock skip token 0-1, dmv penalty coefficient (all format mode)
0x460 VENC_SWREG280 — VENC segment 3: intra 16x16 mode 0-2 penalty register
  [31:0] SWREG_FIELD — segment 3: intra 16x16 mode 0-2 penalty (all format mode)
0x464 VENC_SWREG281 — VENC segment 3: intra 16x16 mode 3 penalty, intra 4x4 mode 0-1 penalty register
  [31:0] SWREG_FIELD — segment 3: intra 16x16 mode 3 penalty, intra 4x4 mode 0-1 penalty (all format mode)
0x468 VENC_SWREG282 — VENC segment 3: intra 4x4 mode 2-4 penalty register
  [31:0] SWREG_FIELD — segment 3: intra 4x4 mode 2-4 penalty (all format mode)
0x46C VENC_SWREG283 — VENC segment 3: intra 4x4 mode 5-7 penalty register
  [31:0] SWREG_FIELD — segment 3: intra 4x4 mode 5-7 penalty (all format mode)
0x470 VENC_SWREG284 — VENC segment 3: intra 4x4 mode 8-9 penalty, intra 4x4 previous mode favor for H.264 register
  [31:0] SWREG_FIELD — segment 3: intra 4x4 mode 8-9 penalty, intra 4x4 previous mode favor for H.264 (all format mode)
0x474 VENC_SWREG285 — VENC segment 3: bit cost of inter type, intra 16x16 mode favor register
  [31:0] SWREG_FIELD — segment 3: Bit cost of inter type, intra 16x16 mode favor (all format mode)
0x478 VENC_SWREG286 — VENC segment 3: inter MB mode favor in intra/inter selection, inter MB mode favor, penalty value for second reference frame register
  [31:0] SWREG_FIELD — segment 3: inter MB mode favor in intra/inter selection, inter MB mode favor, penalty value for second reference frame (all format mode)
0x47C VENC_SWREG287 — VENC segment 3: penalty value register
  [31:0] SWREG_FIELD — segment 3: penalty value (all format mode)
0x480 VENC_SWREG288 — VENC segment 3: penalty value register
  [31:0] SWREG_FIELD — segment 3: penalty value (all format mode)
0x484 VENC_SWREG289 — VENC segment 3: deadzone rate multiplier for plane 0-1 register
  [31:0] SWREG_FIELD — segment 3: Deadzone rate multiplier for plane 0-1 (all format mode)
0x488 VENC_SWREG290 — VENC segment 3: deadzone rate multiplier for plane 2-3 register
  [31:0] SWREG_FIELD — segment 3: Deadzone rate multiplier for plane 2-3 (all format mode)
0x48C VENC_SWREG291 — VENC segment 3: deadzone rate for macroblock skip token 0-1, dmv penalty coefficient register
  [31:0] SWREG_FIELD — segment 3: Deadzone rate for macroblock skip token 0-1, dmv penalty coefficient (all format mode)
0x490 VENC_SWREG292 — VENC VP8 average variance in prev frame register
  [31:0] SWREG_FIELD — VP8 average variance in prev frame (all format mode)
0x494 VENC_SWREG293 — VENC VP8 16384/average variance in prev frame, H264 field control register
  [31:0] SWREG_FIELD — VP8 16384/avgVar in prev frame, H264 Field control (all format mode)
0x498 VENC_SWREG294 — VENC Mb boost register
  [31:0] SWREG_FIELD — Mb boost (all format mode)
0x49C VENC_SWREG295 — VENC variance control, Pskop conding mode register
  [31:0] SWREG_FIELD — Variance control, Pskop conding mode (all format mode)
0x4A0 VENC_SWREG296 ro reset 0x6800000 — VENC synthesis configuration register encoder 1 read only register
  [31:0] SWREG_FIELD — Synthesis configuration register encoder 1 (read only) (all format mode)
0x4A4 VENC_SWREG297 — VENC MBRC control register
  [31:0] SWREG_FIELD — MBRC control (all format mode)
0x4A8 VENC_SWREG298 — VENC segment 4: intra 4x4 previous mode favor, intra 16x16 mode favor, penalty value for second reference frame register
  [31:0] SWREG_FIELD — segment 4: intra 4x4 previous mode favor, intra 16x16 mode favor, penalty value for second reference frame (all format mode)
0x4AC VENC_SWREG299 — VENC segment 4: skip mode penalty, inter MB mode favor register
  [31:0] SWREG_FIELD — segment 4: skip mode penalty, inter MB mode favor (all format mode)
0x4B0 VENC_SWREG300 — VENC segment 4: penalty value register
  [31:0] SWREG_FIELD — segment 4: penalty value (all format mode)
0x4B4 VENC_SWREG301 — VENC segment 4: penalty value register
  [31:0] SWREG_FIELD — segment 4: penalty value (all format mode)
0x4B8 VENC_SWREG302 — VENC segment 5: intra 4x4 previous mode favor, intra 16x16 mode favor, penalty value for second reference frame register
  [31:0] SWREG_FIELD — segment 5: intra 4x4 previous mode favor, intra 16x16 mode favor, penalty value for second reference frame (all format mode)
0x4BC VENC_SWREG303 — VENC segment 5: skip mode penalty, inter MB mode favor register
  [31:0] SWREG_FIELD — segment 5: skip mode penalty, inter MB mode favor (all format mode)
0x4C0 VENC_SWREG304 — VENC segment 5: penalty value register
  [31:0] SWREG_FIELD — segment 5: penalty value (all format mode)
0x4C4 VENC_SWREG305 — VENC segment 5: penalty value register
  [31:0] SWREG_FIELD — segment 5: penalty value (all format mode)
0x4C8 VENC_SWREG306 — VENC segment 6: intra 4x4 previous mode favor, intra 16x16 mode favor, penalty value for second reference frame register
  [31:0] SWREG_FIELD — segment 6: intra 4x4 previous mode favor, intra 16x16 mode favor, penalty value for second reference frame (all format mode)
0x4CC VENC_SWREG307 — VENC segment 6: skip mode penalty, inter MB mode favor register
  [31:0] SWREG_FIELD — segment 6: skip mode penalty, inter MB mode favor (all format mode)
0x4D0 VENC_SWREG308 — VENC segment 6: penalty value register
  [31:0] SWREG_FIELD — segment 6: penalty value (all format mode)
0x4D4 VENC_SWREG309 — VENC segment 6: penalty value register
  [31:0] SWREG_FIELD — segment 6: penalty value (all format mode)
0x4D8 VENC_SWREG310 — VENC segment 7: intra 4x4 previous mode favor, intra 16x16 mode favor, penalty value for second reference frame register
  [31:0] SWREG_FIELD — segment 7: intra 4x4 previous mode favor, intra 16x16 mode favor, penalty value for second reference frame (all format mode)
0x4DC VENC_SWREG311 — VENC segment 7: skip mode penalty, inter MB mode favor register
  [31:0] SWREG_FIELD — segment 7: skip mode penalty, inter MB mode favor (all format mode)
0x4E0 VENC_SWREG312 — VENC segment 7: penalty value register
  [31:0] SWREG_FIELD — segment 7: penalty value (all format mode)
0x4E4 VENC_SWREG313 — VENC segment 7: penalty value register
  [31:0] SWREG_FIELD — segment 7: penalty value (all format mode)
0x4E8 VENC_SWREG314 — VENC segment 8: intra 4x4 previous mode favor, intra 16x16 mode favor, penalty value for second reference frame register
  [31:0] SWREG_FIELD — segment 8: intra 4x4 previous mode favor, intra 16x16 mode favor, penalty value for second reference frame (all format mode)
0x4EC VENC_SWREG315 — VENC segment 8: skip mode penalty, inter MB mode favor register
  [31:0] SWREG_FIELD — segment 8: skip mode penalty, inter MB mode favor (all format mode)
0x4F0 VENC_SWREG316 — VENC segment 8: penalty value register
  [31:0] SWREG_FIELD — segment 8: penalty value (all format mode)
0x4F4 VENC_SWREG317 — VENC segment 8: penalty value register
  [31:0] SWREG_FIELD — segment 8: penalty value (all format mode)
0x4F8 VENC_SWREG318 — VENC segment 9: intra 4x4 previous mode favor, intra 16x16 mode favor, penalty value for second reference frame register
  [31:0] SWREG_FIELD — segment 9: intra 4x4 previous mode favor, intra 16x16 mode favor, penalty value for second reference frame (all format mode)
0x4FC VENC_SWREG319 — VENC segment 9: skip mode penalty, inter MB mode favor register
  [31:0] SWREG_FIELD — segment 9: skip mode penalty, inter MB mode favor (all format mode)
0x500 VENC_SWREG320 — VENC segment 9: penalty value register
  [31:0] SWREG_FIELD — segment 9: penalty value (all format mode)
0x504 VENC_SWREG321 — VENC segment 9: penalty value register
  [31:0] SWREG_FIELD — segment 9: penalty value (all format mode)
0x508 VENC_SWREG322 — VENC segment 10: intra 4x4 previous mode favor, intra 16x16 mode favor, penalty value for second reference frame register
  [31:0] SWREG_FIELD — segment 10: intra 4x4 previous mode favor, intra 16x16 mode favor, penalty value for second reference frame (all format mode)
0x50C VENC_SWREG323 — VENC segment 10: skip mode penalty, inter MB mode favor register
  [31:0] SWREG_FIELD — segment 10: skip mode penalty, inter MB mode favor (all format mode)
0x510 VENC_SWREG324 — VENC segment 10: penalty value register
  [31:0] SWREG_FIELD — segment 10: penalty value (all format mode)
0x514 VENC_SWREG325 — VENC segment 10: penalty value register
  [31:0] SWREG_FIELD — segment 10: penalty value (all format mode)
0x518 VENC_SWREG326 — VENC segment 11: intra 4x4 previous mode favor, intra 16x16 mode favor, penalty value for second reference frame register
  [31:0] SWREG_FIELD — segment 11: intra 4x4 previous mode favor, intra 16x16 mode favor, penalty value for second reference frame (all format mode)
0x51C VENC_SWREG327 — VENC segment 11: skip mode penalty, inter MB mode favor register
  [31:0] SWREG_FIELD — segment 11: skip mode penalty, inter MB mode favor (all format mode)
0x520 VENC_SWREG328 — VENC segment 11: penalty value register
  [31:0] SWREG_FIELD — segment 11: penalty value (all format mode)
0x524 VENC_SWREG329 — VENC segment 11: penalty value register
  [31:0] SWREG_FIELD — segment 11: penalty value (all format mode)
0x528 VENC_SWREG330 — VENC segment 12: intra 4x4 previous mode favor, intra 16x16 mode favor, penalty value for second reference frame register
  [31:0] SWREG_FIELD — segment 12: intra 4x4 previous mode favor, intra 16x16 mode favor, penalty value for second reference frame (all format mode)
0x52C VENC_SWREG331 — VENC segment 12: skip mode penalty, inter MB mode favor register
  [31:0] SWREG_FIELD — segment 12: skip mode penalty, inter MB mode favor (all format mode)
0x530 VENC_SWREG332 — VENC segment 12: penalty value register
  [31:0] SWREG_FIELD — segment 12: penalty value (all format mode)
0x534 VENC_SWREG333 — VENC segment 12: penalty value register
  [31:0] SWREG_FIELD — segment 12: penalty value (all format mode)
0x538 VENC_SWREG334 — VENC segment 13: intra 4x4 previous mode favor, intra 16x16 mode favor, penalty value for second reference frame register
  [31:0] SWREG_FIELD — segment 13: intra 4x4 previous mode favor, intra 16x16 mode favor, penalty value for second reference frame (all format mode)
0x53C VENC_SWREG335 — VENC segment 13: skip mode penalty, inter MB mode favor register
  [31:0] SWREG_FIELD — segment 13: skip mode penalty, inter MB mode favor (all format mode)
0x540 VENC_SWREG336 — VENC segment 13: penalty value register
  [31:0] SWREG_FIELD — segment 13: penalty value (all format mode)
0x544 VENC_SWREG337 — VENC segment 13: penalty value register
  [31:0] SWREG_FIELD — segment 13: penalty value (all format mode)
0x548 VENC_SWREG338 — VENC segment 14: intra 4x4 previous mode favor, intra 16x16 mode favor, penalty value for second reference frame register
  [31:0] SWREG_FIELD — segment 14: intra 4x4 previous mode favor, intra 16x16 mode favor, penalty value for second reference frame (all format mode)
0x54C VENC_SWREG339 — VENC segment 14: skip mode penalty, inter MB mode favor register
  [31:0] SWREG_FIELD — segment 14: skip mode penalty, inter MB mode favor (all format mode)
0x550 VENC_SWREG340 — VENC segment 14: penalty value register
  [31:0] SWREG_FIELD — segment 14: penalty value (all format mode)
0x554 VENC_SWREG341 — VENC segment 14: penalty value register
  [31:0] SWREG_FIELD — segment 14: penalty value (all format mode)
0x558 VENC_SWREG342 — VENC segment 15: intra 4x4 previous mode favor, intra 16x16 mode favor, penalty value for second reference frame register
  [31:0] SWREG_FIELD — segment 15: intra 4x4 previous mode favor, intra 16x16 mode favor, penalty value for second reference frame (all format mode)
0x55C VENC_SWREG343 — VENC segment 15: skip mode penalty, inter MB mode favor register
  [31:0] SWREG_FIELD — segment 15: skip mode penalty, inter MB mode favor (all format mode)
0x560 VENC_SWREG344 — VENC segment 15: penalty value register
  [31:0] SWREG_FIELD — segment 15: penalty value (all format mode)
0x564 VENC_SWREG345 — VENC segment 15: penalty value register
  [31:0] SWREG_FIELD — segment 15: penalty value (all format mode)
0x568 VENC_SWREG346 — VENC segment 16: intra 4x4 previous mode favor, intra 16x16 mode favor, penalty value for second reference frame register
  [31:0] SWREG_FIELD — segment 16: intra 4x4 previous mode favor, intra 16x16 mode favor, penalty value for second reference frame (all format mode)
0x56C VENC_SWREG347 — VENC segment 16: skip mode penalty, inter MB mode favor register
  [31:0] SWREG_FIELD — segment 16: skip mode penalty, inter MB mode favor (all format mode)
0x570 VENC_SWREG348 — VENC segment 16: penalty value register
  [31:0] SWREG_FIELD — segment 16: penalty value (all format mode)
0x574 VENC_SWREG349 — VENC segment 16: penalty value register
  [31:0] SWREG_FIELD — segment 16: penalty value (all format mode)
0x578 VENC_SWREG350 — VENC segment 17: intra 4x4 previous mode favor, intra 16x16 mode favor, penalty value for second reference frame register
  [31:0] SWREG_FIELD — segment 17: intra 4x4 previous mode favor, intra 16x16 mode favor, penalty value for second reference frame (all format mode)
0x57C VENC_SWREG351 — VENC segment 17: skip mode penalty, inter MB mode favor register
  [31:0] SWREG_FIELD — segment 17: skip mode penalty, inter MB mode favor (all format mode)
0x580 VENC_SWREG352 — VENC segment 17: penalty value register
  [31:0] SWREG_FIELD — segment 17: penalty value (all format mode)
0x584 VENC_SWREG353 — VENC segment 17: penalty value register
  [31:0] SWREG_FIELD — segment 17: penalty value (all format mode)
0x588 VENC_SWREG354 — VENC segment 18: intra 4x4 previous mode favor, intra 16x16 mode favor, penalty value for second reference frame register
  [31:0] SWREG_FIELD — segment 18: intra 4x4 previous mode favor, intra 16x16 mode favor, penalty value for second reference frame (all format mode)
0x58C VENC_SWREG355 — VENC segment 18: skip mode penalty, inter MB mode favor register
  [31:0] SWREG_FIELD — segment 18: skip mode penalty, inter MB mode favor (all format mode)
0x590 VENC_SWREG356 — VENC segment 18: penalty value register
  [31:0] SWREG_FIELD — segment 18: penalty value (all format mode)
0x594 VENC_SWREG357 — VENC segment 18: penalty value register
  [31:0] SWREG_FIELD — segment 18: penalty value (all format mode)
0x598 VENC_SWREG358 — VENC segment 19: intra 4x4 previous mode favor, intra 16x16 mode favor, penalty value for second reference frame register
  [31:0] SWREG_FIELD — segment 19: intra 4x4 previous mode favor, intra 16x16 mode favor, penalty value for second reference frame (all format mode)
0x59C VENC_SWREG359 — VENC segment 19: skip mode penalty, inter MB mode favor register
  [31:0] SWREG_FIELD — segment 19: skip mode penalty, inter MB mode favor (all format mode)
0x5A0 VENC_SWREG360 — VENC segment 19: penalty value register
  [31:0] SWREG_FIELD — segment 19: penalty value (all format mode)
0x5A4 VENC_SWREG361 — VENC segment 19: penalty value register
  [31:0] SWREG_FIELD — segment 19: penalty value (all format mode)
0x5A8 VENC_SWREG362 — VENC segment 20: intra 4x4 previous mode favor, intra 16x16 mode favor, penalty value for second reference frame register
  [31:0] SWREG_FIELD — segment 20: intra 4x4 previous mode favor, intra 16x16 mode favor, penalty value for second reference frame (all format mode)
0x5AC VENC_SWREG363 — VENC segment 20: skip mode penalty, inter MB mode favor register
  [31:0] SWREG_FIELD — segment 20: skip mode penalty, inter MB mode favor (all format mode)
0x5B0 VENC_SWREG364 — VENC segment 20: penalty value register
  [31:0] SWREG_FIELD — segment 20: penalty value (all format mode)
0x5B4 VENC_SWREG365 — VENC segment 20: penalty value register
  [31:0] SWREG_FIELD — segment 20: penalty value (all format mode)
0x5B8 VENC_SWREG366 — VENC segment 21: intra 4x4 previous mode favor, intra 16x16 mode favor, penalty value for second reference frame register
  [31:0] SWREG_FIELD — segment 21: intra 4x4 previous mode favor, intra 16x16 mode favor, penalty value for second reference frame (all format mode)
0x5BC VENC_SWREG367 — VENC segment 21: skip mode penalty, inter MB mode favor register
  [31:0] SWREG_FIELD — segment 21: skip mode penalty, inter MB mode favor (all format mode)
0x5C0 VENC_SWREG368 — VENC segment 21: penalty value register
  [31:0] SWREG_FIELD — segment 21: penalty value (all format mode)
0x5C4 VENC_SWREG369 — VENC segment 21: penalty value register
  [31:0] SWREG_FIELD — segment 21: penalty value (all format mode)
0x5C8 VENC_SWREG370 — VENC segment 22: intra 4x4 previous mode favor, intra 16x16 mode favor, penalty value for second reference frame register
  [31:0] SWREG_FIELD — segment 22: intra 4x4 previous mode favor, intra 16x16 mode favor, penalty value for second reference frame (all format mode)
0x5CC VENC_SWREG371 — VENC segment 22: skip mode penalty, inter MB mode favor register
  [31:0] SWREG_FIELD — segment 22: skip mode penalty, inter MB mode favor (all format mode)
0x5D0 VENC_SWREG372 — VENC segment 22: penalty value register
  [31:0] SWREG_FIELD — segment 22: penalty value (all format mode)
0x5D4 VENC_SWREG373 — VENC segment 22: penalty value register
  [31:0] SWREG_FIELD — segment 22: penalty value (all format mode)
0x5D8 VENC_SWREG374 — VENC segment 23: intra 4x4 previous mode favor, intra 16x16 mode favor, penalty value for second reference frame register
  [31:0] SWREG_FIELD — segment 23: intra 4x4 previous mode favor, intra 16x16 mode favor, penalty value for second reference frame (all format mode)
0x5DC VENC_SWREG375 — VENC segment 23: skip mode penalty, inter MB mode favor register
  [31:0] SWREG_FIELD — segment 23: skip mode penalty, inter MB mode favor (all format mode)
0x5E0 VENC_SWREG376 — VENC segment 23: penalty value register
  [31:0] SWREG_FIELD — segment 23: penalty value (all format mode)
0x5E4 VENC_SWREG377 — VENC segment 23: penalty value register
  [31:0] SWREG_FIELD — segment 23: penalty value (all format mode)
0x5E8 VENC_SWREG378 — VENC segment 24: intra 4x4 previous mode favor, intra 16x16 mode favor, penalty value for second reference frame register
  [31:0] SWREG_FIELD — segment 24: intra 4x4 previous mode favor, intra 16x16 mode favor, penalty value for second reference frame (all format mode)
0x5EC VENC_SWREG379 — VENC segment 24: skip mode penalty, inter MB mode favor register
  [31:0] SWREG_FIELD — segment 24: skip mode penalty, inter MB mode favor (all format mode)
0x5F0 VENC_SWREG380 — VENC segment 24: penalty value register
  [31:0] SWREG_FIELD — segment 24: penalty value (all format mode)
0x5F4 VENC_SWREG381 — VENC segment 24: penalty value register
  [31:0] SWREG_FIELD — segment 24: penalty value (all format mode)
0x5F8 VENC_SWREG382 — VENC segment 25: intra 4x4 previous mode favor, intra 16x16 mode favor, penalty value for second reference frame register
  [31:0] SWREG_FIELD — segment 25: intra 4x4 previous mode favor, intra 16x16 mode favor, penalty value for second reference frame (all format mode)
0x5FC VENC_SWREG383 — VENC segment 25: skip mode penalty, inter MB mode favor register
  [31:0] SWREG_FIELD — segment 25: skip mode penalty, inter MB mode favor (all format mode)
0x600 VENC_SWREG384 — VENC segment 25: penalty value register
  [31:0] SWREG_FIELD — segment 25: penalty value (all format mode)
0x604 VENC_SWREG385 — VENC segment 25: penalty value register
  [31:0] SWREG_FIELD — segment 25: penalty value (all format mode)
0x608 VENC_SWREG386 — VENC segment 26: intra 4x4 previous mode favor, intra 16x16 mode favor, penalty value for second reference frame register
  [31:0] SWREG_FIELD — segment 26: intra 4x4 previous mode favor, intra 16x16 mode favor, penalty value for second reference frame (all format mode)
0x60C VENC_SWREG387 — VENC segment 26: skip mode penalty, inter MB mode favor register
  [31:0] SWREG_FIELD — segment 26: skip mode penalty, inter MB mode favor (all format mode)
0x610 VENC_SWREG388 — VENC segment 26: penalty value register
  [31:0] SWREG_FIELD — segment 26: penalty value (all format mode)
0x614 VENC_SWREG389 — VENC segment 26: penalty value register
  [31:0] SWREG_FIELD — segment 26: penalty value (all format mode)
0x618 VENC_SWREG390 — VENC segment 27: intra 4x4 previous mode favor, intra 16x16mode favor, penalty value for second reference frame register
  [31:0] SWREG_FIELD — segment 27: intra 4x4 previous mode favor, intra 16x16 mode favor, penalty value for second reference frame (all format mode)
0x61C VENC_SWREG391 — VENC segment 27: skip mode penalty, inter MB mode favor register
  [31:0] SWREG_FIELD — segment 27: skip mode penalty, inter MB mode favor (all format mode)
0x620 VENC_SWREG392 — VENC segment 27: penalty value register
  [31:0] SWREG_FIELD — segment 27: penalty value (all format mode)
0x624 VENC_SWREG393 — VENC segment 27: penalty value register
  [31:0] SWREG_FIELD — segment 27: penalty value (all format mode)
0x628 VENC_SWREG394 — VENC segment 28: intra 4x4 previous mode favor, intra 16x16mode favor, penalty value for second reference frame register
  [31:0] SWREG_FIELD — segment 28: intra 4x4 previous mode favor, intra 16x16 mode favor, penalty value for second reference frame (all format mode)
0x62C VENC_SWREG395 — VENC segment 28: skip mode penalty, inter MB mode favor register
  [31:0] SWREG_FIELD — segment 28: skip mode penalty, inter MB mode favor (all format mode)
0x630 VENC_SWREG396 — VENC segment 28: penalty value register
  [31:0] SWREG_FIELD — segment 28: penalty value (all format mode)
0x634 VENC_SWREG397 — VENC segment 28: penalty value register
  [31:0] SWREG_FIELD — segment 28: penalty value (all format mode)
0x638 VENC_SWREG398 — VENC segment 29: intra 4x4 previous mode favor, intra 16x16 mode favor, penalty value for second reference frame register
  [31:0] SWREG_FIELD — segment 29: intra 4x4 previous mode favor, intra 16x16 mode favor, penalty value for second reference frame (all format mode)
0x63C VENC_SWREG399 — VENC segment 29: skip mode penalty, inter MB mode favor register
  [31:0] SWREG_FIELD — segment 29: skip mode penalty, inter MB mode favor (all format mode)
0x640 VENC_SWREG400 — VENC segment 29: penalty value register
  [31:0] SWREG_FIELD — segment 29: penalty value (all format mode)
0x644 VENC_SWREG401 — VENC segment 29: penalty value register
  [31:0] SWREG_FIELD — segment 29: penalty value (all format mode)
0x648 VENC_SWREG402 — VENC segment 30: intra 4x4 previous mode favor, intra 16x16 mode favor, penalty value for second reference frame register
  [31:0] SWREG_FIELD — segment 30: intra 4x4 previous mode favor, intra 16x16 mode favor, penalty value for second reference frame (all format mode)
0x64C VENC_SWREG403 — VENC segment 30: skip mode penalty, inter MB mode favor register
  [31:0] SWREG_FIELD — segment 30: skip mode penalty, inter MB mode favor (all format mode)
0x650 VENC_SWREG404 — VENC segment 30: penalty value register
  [31:0] SWREG_FIELD — segment 30: penalty value (all format mode)
0x654 VENC_SWREG405 — VENC segment 30: penalty value register
  [31:0] SWREG_FIELD — segment 30: penalty value (all format mode)
0x658 VENC_SWREG406 — VENC segment 31: intra 4x4 previous mode favor, intra 16x16 mode favor, penalty value for second reference frame register
  [31:0] SWREG_FIELD — segment 31: intra 4x4 previous mode favor, intra 16x16 mode favor, penalty value for second reference frame (all format mode)
0x65C VENC_SWREG407 — VENC segment 31: skip mode penalty, inter MB mode favor register
  [31:0] SWREG_FIELD — segment 31: skip mode penalty, inter MB mode favor (all format mode)
0x660 VENC_SWREG408 — VENC segment 31: penalty value register
  [31:0] SWREG_FIELD — segment 31: penalty value (all format mode)
0x664 VENC_SWREG409 — VENC segment 31: penalty value register
  [31:0] SWREG_FIELD — segment 31: penalty value (all format mode)
0x668 VENC_SWREG410 — VENC MBRC control, QP, offset, enable register
  [31:0] SWREG_FIELD — MBRC control (QP, offset, enable) (all format mode)
0x66C VENC_SWREG411 — VENC gain of MB QP delta. 8.8 format register
  [31:0] SWREG_FIELD — gain of MB QPdelta. 8.8 format (all format mode)
0x670 VENC_SWREG412 — VENC average of MB complexity register
  [31:0] SWREG_FIELD — average of MB complexity (all format mode)
0x694 VENC_SWREG421 — VENC reorder control register
  [31:0] SWREG_FIELD — Reorder control (all format mode)
0x698 VENC_SWREG422 — VENC AXI read ID register
  [31:0] SWREG_FIELD — AXI Read ID (all format mode)
0x69C VENC_SWREG423 — VENC base address MSB for reference luma compression table register
  [31:0] SWREG_FIELD — AXI Read ID (all format mode)
0x6A0 VENC_SWREG424 — VENC base address MSB for reference chroma compression table register
  [31:0] SWREG_FIELD — AXI Read ID (all format mode)
0x6A4 VENC_SWREG425 — VENC base address MSB for reconstructed luma compression table register
  [31:0] SWREG_FIELD — AXI Read ID (all format mode)
0x6A8 VENC_SWREG426 — VENC base address for reconstructed chroma compression table register
  [31:0] SWREG_FIELD — Base address for reconstructed chroma compression table (all format mode)
0x6AC VENC_SWREG427 — VENC base address MSB for second reference luma compression table register
  [31:0] SWREG_FIELD — Base address MSB for second reference luma compression table (all format mode)
0x6B0 VENC_SWREG428 — VENC base address MSB for second reference chroma compression table register
  [31:0] SWREG_FIELD — Base address MSB for second reference chroma compression table (all format mode)
0x6B4 VENC_SWREG429 — VENC high 32 bits of base address for output stream data register
  [31:0] SWREG_FIELD — high 32 bits of Base address for output stream data (all format mode)
0x6B8 VENC_SWREG430 — VENC high 32 bits of base address for output control data register
  [31:0] SWREG_FIELD — high 32 bits of Base address for output control data (all format mode)
0x6BC VENC_SWREG431 — VENC high 32 bits of base address for reference luma register
  [31:0] SWREG_FIELD — high 32 bits of Base address for reference luma (all format mode)
0x6C0 VENC_SWREG432 — VENC high 32 bits of base address for reference chroma register
  [31:0] SWREG_FIELD — high 32 bits of Base address for reference chroma (all format mode)
0x6C4 VENC_SWREG433 — VENC high 32 bits of base address for reconstructed luma register
  [31:0] SWREG_FIELD — high 32 bits of Base address for reconstructed luma (all format mode)
0x6C8 VENC_SWREG434 — VENC high 32 bits of base address for reconstructed chroma register
  [31:0] SWREG_FIELD — high 32 bits of Base address for reconstructed chroma (all format mode)
0x6CC VENC_SWREG435 — VENC high 32 bits of base address for input picture luma register
  [31:0] SWREG_FIELD — high 32 bits of Base address for input picture luma (all format mode)
0x6D0 VENC_SWREG436 — VENC high 32 bits of base address for input picture cb register
  [31:0] SWREG_FIELD — high 32 bits of Base address for input picture cb (all format mode)
0x6D4 VENC_SWREG437 — VENC high 32 bits of base address for input picture cr register
  [31:0] SWREG_FIELD — high 32 bits of Base address for input picture cr (all format mode)
0x6D8 VENC_SWREG438 — VENC high 32 bits of base address for second reference luma register
  [31:0] SWREG_FIELD — high 32 bits of Base address for second reference luma (all format mode)
0x6DC VENC_SWREG439 — VENC high 32 bits of base address for second reference chroma register
  [31:0] SWREG_FIELD — high 32 bits of Base address for second reference chroma (all format mode)
0x6E0 VENC_SWREG440 — VENC high 32 bits of H264 secondary ref pic base register
  [31:0] SWREG_FIELD — high 32 bits of H264 secondary ref pic base (all format mode)
0x6E4 VENC_SWREG441 — VENC high 32 bits of H264 secondary ref pic base register
  fields as VENC_SWREG440
0x6E8 VENC_SWREG442 — VENC high 32 bits of base address for next pic luminance register
  [31:0] SWREG_FIELD — high 32 bits of Base address for next pic luminance (all format mode)
0x6EC VENC_SWREG443 — VENC high 32 bits of base address for cabac context tables H264 or probability tables VP8 register
  [31:0] SWREG_FIELD — high 32 bits of Base address for cabac context tables (H264) or probability tables (VP8) (all format mode)
0x6F0 VENC_SWREG444 — VENC high 32 bits of base address for MV output writing register
  [31:0] SWREG_FIELD — high 32 bits of Base address for MV output writing (all format mode)
0x6F4 VENC_SWREG445 — VENC high 32 bits of base address for VP8 1st DCT partition register
  [31:0] SWREG_FIELD — high 32 bits of Base address for VP8 1st DCT partition (all format mode)
0x6F8 VENC_SWREG446 — VENC high 32 bits of base address for VP8 2nd DCT partition register
  [31:0] SWREG_FIELD — high 32 bits of Base address for VP8 2nd DCT partition (all format mode)
0x6FC VENC_SWREG447 — VENC high 32 bits of base address for VP8 counters for probability updates register
  [31:0] SWREG_FIELD — high 32 bits of Base address for VP8 counters for probability updates (all format mode)
0x700 VENC_SWREG448 — VENC high 32 bits of base address for VP8 segmentation map segment Id 2- bits/macroblock register
  [31:0] SWREG_FIELD — high 32 bits of Base address for VP8 segmentation map. segmentId 2-bits/macroblock (all format mode)
0x704 VENC_SWREG449 — VENC high 32 bits of base address for output of down-scaled encoder image in YUYV 4:2:2 format register
  [31:0] SWREG_FIELD — high 32 bits of Base address for output of down-scaled encoder image in YUYV 4:2:2 format (all format mode)
0x708 VENC_SWREG450 — VENC high 32 bits of base address for VP8 3rd DCT partition register
  [31:0] SWREG_FIELD — high 32 bits of Base address for VP8 3rd DCT partition (all format mode)
0x70C VENC_SWREG451 — VENC high 32 bits of base address for VP8 4th DCT partition register
  [31:0] SWREG_FIELD — high 32 bits of Base address for VP8 4th DCT partition (all format mode)
0x7C4 VENC_SWREG497 — VENC low-latency control register
  [31:0] SWREG_FIELD — Low latency control (all format mode)
