# STM32MP25_CM33 register map
File version: 1.3
CPU: CM33 r0p1, little endian, MPU, FPU, vendor SysTick, 8 interrupt priority bits
Registers are 32-bit, read-write, reset 0x0 unless marked. A register's access mark holds for its fields unless they carry their own. Offsets are from the block's base; lines under a group give offsets from that group; [hi:lo] are bit positions; {n}, {i} and the like mark numbered series; 'fields as' and 'values as' point back to an identical list; <NAME> marks a mode.

## Memory map
0x40000000 TIM2 size 0x400 — General-purpose timers
0x40010000 TIM3 size 0x400
0x40020000 TIM4 size 0x400
0x40030000 TIM5 size 0x400
0x40040000 TIM6 size 0x400 — TIM6 address block description
0x40050000 TIM7 size 0x400
0x40060000 TIM12 size 0x400 — General-purpose timers
0x40070000 TIM13 size 0x400
0x40080000 TIM14 size 0x400
0x40090000 LPTIM1 size 0x400 — LPTIM1 address block description
0x400A0000 LPTIM2 size 0x400
0x400B0000 SPI2 size 0x400
0x400C0000 SPI3 size 0x400
0x400D0000 SPDIFRX size 0x400 — SPDIFRX address block description
0x400E0000 USART2 size 0x400
0x400F0000 USART3 size 0x400
0x40100000 UART4 size 0x400
0x40110000 UART5 size 0x400
0x40120000 I2C1 size 0x400 — I2C address block description
0x40130000 I2C2 size 0x400
0x40140000 I2C3 size 0x400
0x40150000 I2C4 size 0x400
0x40160000 I2C5 size 0x400
0x40170000 I2C6 size 0x400
0x40180000 I2C7 size 0x400
0x40190000 I3C1 size 0x400 — I3C register block
0x401A0000 I3C2 size 0x400
0x401B0000 I3C3 size 0x400
0x401C0000 TIM10 size 0x400 — General-purpose timers
0x401D0000 TIM11 size 0x400
0x40200000 TIM1 size 0x400 — TIM1 address block description
0x40210000 TIM8 size 0x400
0x40220000 USART6 size 0x400
0x40230000 SPI1 size 0x400 — SPI1 address block description
0x40240000 SPI4 size 0x400
0x40250000 TIM15 size 0x400 — General purpose timers
0x40260000 TIM16 size 0x400 — General purpose timers
0x40270000 TIM17 size 0x400
0x40280000 SPI5 size 0x400
0x40290000 SAI1 size 0x400 — SAI register block
0x402A0000 SAI2 size 0x400
0x402B0000 SAI3 size 0x400
0x402C0000 UART9 size 0x400
0x402D0000 FDCAN1 size 0x304 — FDCAN address block description
0x402E0000 FDCAN2 size 0x304
0x402F0000 FDCAN3 size 0x304
0x40320000 TIM20 size 0x400
0x40330000 USART1 size 0x400 — USART1 address block description
0x40340000 SAI4 size 0x400
0x40350000 SPI6 size 0x400
0x40360000 SPI7 size 0x400
0x40370000 UART7 size 0x400
0x40380000 UART8 size 0x400
0x40400000 HPDMA1 size 0x1000 — HPDMA register block
0x40410000 HPDMA2 size 0x1000
0x40420000 HPDMA3 size 0x1000
0x40430000 OCTOSPI1 size 0x400 — OCTOSPI register block
0x40440000 OCTOSPI2 size 0x400
0x40450000 OTFDEC1 size 0x400 — OTFDEC register bank
0x40460000 OTFDEC2 size 0x400
0x40470000 ICACHE size 0x400 — ICACHE register block
0x40480000 DCACHE size 0x400 — DCACHE register block
0x40490000 IPCC1 size 0x400 — IPCC address block description
0x404A0000 DCMI size 0x400 — DCMI address block description
0x404B0000 PSSI size 0x400 — PSSI register block
0x404C0000 CRC size 0x400 — CRC address block description
0x404D0000 MDF1 size 0x1000 — MDF register block
0x404E0000 ADC1 size 0x100 — ADC register block
0x404E0100 ADC2 size 0x100
0x404E0300 ADCC12 size 0x100 — ADCC12 register block
0x404F0000 ADCC3 size 0x100 — ADCC3 register block
0x40500000 OCTOSPIM size 0x400 — OCTOSPIM register block
0x42010000 HASH size 0x400 — HASH register bank
0x42020000 RNG size 0x400 — RNG address block description
0x42030000 CRYP1 size 0x400 — CRYP address block description
0x42040000 CRYP2 size 0x400
0x42050000 SAES size 0x400 — SAES register block
0x42060000 PKA size 0x2000 — PKA register blank and RAM
0x42070000 RAMCFG size 0xFFF — RAMCFG register bank
0x42080000 RIFSC size 0x1000 — RIFSC register block
0x42090000 IAC size 0x400 — IAC register block
0x420A0000 RISAF1 size 0x1000 — RISAF register block
0x420B0000 RISAF2 size 0x1000
0x420D0000 RISAF4 size 0x1000
0x420E0000 RISAF5 size 0x1000
0x420F0000 RISAB1 size 0x1000 — RISAB register block
0x42100000 RISAB2 size 0x1000
0x42110000 RISAB3 size 0x1000
0x42120000 RISAB4 size 0x1000
0x42130000 RISAB5 size 0x1000
0x42140000 RISAB6 size 0x1000
0x44000000 BSEC size 0x1000 — BSEC register block
0x44010000 IWDG1 size 0x400 — IWDG address block description
0x44020000 IWDG2 size 0x400
0x44030000 IWDG3 size 0x400
0x44040000 IWDG4 size 0x400
0x44050000 WWDG1 size 0x400 — WWDG address block description
0x44060000 VREFBUF size 0x8 — VREFBUF address block description
0x44070000 DTS size 0x130 — DTS address block description
0x44080000 SERC size 0x400 — SERC register block
0x44090000 HDP size 0x400 — HDP address block description
0x44200000 RCC size 0x10000 — RCC register block
0x44210000 PWR size 0x400 — PWR register block
0x44220000 EXTI1 size 0x400 — EXTI1 address block description
0x44230000 SYSCFG size 0x8000 — SYSCFG register block
0x44240000 GPIOA size 0x1000 — Control of ioport A
0x44250000 GPIOB size 0x1000 — Control of ioport B
0x44260000 GPIOC size 0x1000 — Control of ioport C
0x44270000 GPIOD size 0x1000 — Control of ioport D
0x44280000 GPIOE size 0x1000 — Control of ioport E
0x44290000 GPIOF size 0x1000 — Control of ioport F
0x442A0000 GPIOG size 0x1000 — Control of ioport G
0x442B0000 GPIOH size 0x1000 — Control of ioport H
0x442C0000 GPIOI size 0x1000 — Control of ioport I
0x442D0000 GPIOJ size 0x1000 — Control of ioport J
0x442E0000 GPIOK size 0x1000 — Control of ioport K
0x46000000 RTC size 0x400 — RTC register block
0x46010000 TAMP size 0x400 — TAMP register block
0x46020000 SPI8 size 0x400
0x46030000 LPUART1 size 0x400 — LPUART address block description
0x46040000 I2C8 size 0x400
0x46050000 LPTIM3 size 0x400
0x46060000 LPTIM4 size 0x400
0x46070000 LPTIM5 size 0xC — LPTIM5 address block description
0x46080000 I3C4 size 0x400
0x46090000 IWDG5 size 0x400
0x460A0000 WWDG2 size 0x400
0x46200000 GPIOZ size 0x1000 — Control of ioport Z
0x46210000 LPDMA size 0x1000 — LPDMA register block
0x46220000 ADF size 0x1000 — ADF register block
0x46230000 EXTI2 size 0x400 — EXTI2 address block description
0x46240000 HSEM size 0x400 — HSEM address block description
0x46250000 IPCC2 size 0x400
0x48000000 DSI size 0x800 — DSI address block description
0x48010000 LTDC size 0x400 — LTDC register block
0x48020000 CSI size 0x2000 — CSI address block description
0x48030000 DCMIPP size 0x1000 — DCMIPP register block
0x48040000 DDRCTRL size 0x1000 — DDRCTRL register block
0x48041000 DDRPERFM size 0x400 — DDRPERFM register block
0x48050000 DDRDBG size 0x11C — DDRDBG address block description
0x48060000 LVDS size 0x2000 — LVDS address block description
0x48070000 STGENR_S size 0x8000
0x48080000 STGENC size 0x1000 — STGENC address block description
0x48090000 GICV2M size 0x1000 — GICV2M register block
0x480A0000 UCPD size 0x400 — UCPD register block
0x480C0000 COMBOPHY size 0xC4 — COMBOPHY register block
0x480D0000 VDEC size 0x1DC — VDEC address block description
0x480E0000 VENC size 0x7C8 — VENC address block description
0x48200000 FMC size 0x400 — FMC address block description
0x48220000 SDMMC1 size 0x400 — SDMMC address block description
0x48230000 SDMMC2 size 0x400
0x48240000 SDMMC3 size 0x400
0x48280000 GPU size 0x668 — GPU register block
0x482C0000 ETH1 size 0x12E4 — ETH address block description
0x482D0000 ETH2 size 0x12E4
0x482E0000 USBH_OHCI size 0xB0
0x482F0000 USBH_EHCI size 0xB0 — USBH address block description
0x48300000 USB3DR size 0x100000 — USB3DR register block
0x48800000 CA35SS size 0x20AC — CA35SS register block
0x48C00000 DDRPHYC size 0x3403EC — DDRPHYC address block description
0x4A010000 DBGMCU size 0x50 — DBGMCU address block description
0x4AC10000 GICD size 0x1000 — GICD address block description
0x4AC20000 GICC size 0x1004 — GICC address block description
0x4AC40000 GICH size 0x110 — GICH address block description
0x4AC60000 GICV size 0x1004 — GICV address block description
0x4C000000 ETHSW size 0x1000426 — ETHSW register block
0x50000000 TIM2_S size 0x400
0x50010000 TIM3_S size 0x400
0x50020000 TIM4_S size 0x400
0x50030000 TIM5_S size 0x400
0x50040000 TIM6_S size 0x400
0x50050000 TIM7_S size 0x400
0x50060000 TIM12_S size 0x400
0x50070000 TIM13_S size 0x400
0x50080000 TIM14_S size 0x400
0x50090000 LPTIM1_S size 0x400
0x500A0000 LPTIM2_S size 0x400
0x500B0000 SPI2_S size 0x400
0x500C0000 SPI3_S size 0x400
0x500D0000 SPDIFRX_S size 0x400
0x500E0000 USART2_S size 0x400
0x500F0000 USART3_S size 0x400
0x50100000 UART4_S size 0x400
0x50110000 UART5_S size 0x400
0x50120000 I2C1_S size 0x400
0x50130000 I2C2_S size 0x400
0x50140000 I2C3_S size 0x400
0x50150000 I2C4_S size 0x400
0x50160000 I2C5_S size 0x400
0x50170000 I2C6_S size 0x400
0x50180000 I2C7_S size 0x400
0x50190000 I3C1_S size 0x400
0x501A0000 I3C2_S size 0x400
0x501B0000 I3C3_S size 0x400
0x501C0000 TIM10_S size 0x400
0x501D0000 TIM11_S size 0x400
0x50200000 TIM1_S size 0x400
0x50210000 TIM8_S size 0x400
0x50220000 USART6_S size 0x400
0x50230000 SPI1_S size 0x400
0x50240000 SPI4_S size 0x400
0x50250000 TIM15_S size 0x400
0x50260000 TIM16_S size 0x400
0x50270000 TIM17_S size 0x400
0x50280000 SPI5_S size 0x400
0x50290000 SAI1_S size 0x400
0x502A0000 SAI2_S size 0x400
0x502B0000 SAI3_S size 0x400
0x502C0000 UART9_S size 0x400
0x502D0000 FDCAN1_S size 0x304
0x502E0000 FDCAN2_S size 0x304
0x502F0000 FDCAN3_S size 0x304
0x50320000 TIM20_S size 0x400
0x50330000 USART1_S size 0x400
0x50340000 SAI4_S size 0x400
0x50350000 SPI6_S size 0x400
0x50360000 SPI7_S size 0x400
0x50370000 UART7_S size 0x400
0x50380000 UART8_S size 0x400
0x50400000 HPDMA1_S size 0x1000
0x50410000 HPDMA2_S size 0x1000
0x50420000 HPDMA3_S size 0x1000
0x50430000 OCTOSPI1_S size 0x400
0x50440000 OCTOSPI2_S size 0x400
0x50450000 OTFDEC1_S size 0x400
0x50460000 OTFDEC2_S size 0x400
0x50470000 ICACHE_S size 0x400
0x50480000 DCACHE_S size 0x400
0x50490000 IPCC1_S size 0x400
0x504A0000 DCMI_S size 0x400
0x504B0000 PSSI_S size 0x400
0x504C0000 CRC_S size 0x400
0x504D0000 MDF1_S size 0x1000
0x504E0000 ADC1_S size 0x100
0x504E0100 ADC2_S size 0x100
0x504E0300 ADC12_S size 0x100
0x504F0000 ADCC3_S size 0x100
0x50500000 OCTOSPIM_S size 0x400
0x52010000 HASH_S size 0x400
0x52020000 RNG_S size 0x400
0x52030000 CRYP1_S size 0x400
0x52040000 CRYP2_S size 0x400
0x52050000 SAES_S size 0x400
0x52060000 PKA_S size 0x2000
0x52070000 RAMCFG_S size 0xFFF
0x52080000 RIFSC_S size 0x1000
0x52090000 IAC_S size 0x400
0x520A0000 RISAF1_S size 0x1000
0x520B0000 RISAF2_S size 0x1000
0x520D0000 RISAF4_S size 0x1000
0x520E0000 RISAF5_S size 0x1000
0x520F0000 RISAB1_S size 0x1000
0x52100000 RISAB2_S size 0x1000
0x52110000 RISAB3_S size 0x1000
0x52120000 RISAB4_S size 0x1000
0x52130000 RISAB5_S size 0x1000
0x52140000 RISAB6_S size 0x1000
0x54000000 BSEC_S size 0x1000
0x54010000 IWDG1_S size 0x400
0x54020000 IWDG2_S size 0x400
0x54030000 IWDG3_S size 0x400
0x54040000 IWDG4_S size 0x400
0x54050000 WWDG1_S size 0x400
0x54060000 VREFBUF_S size 0x8
0x54070000 DTS_S size 0x130
0x54080000 SERC_S size 0x400
0x54090000 HDP_S size 0x400
0x54200000 RCC_S size 0x10000
0x54210000 PWR_S size 0x400
0x54220000 EXTI1_S size 0x400
0x54230000 SYSCFG_S size 0x8000
0x54240000 GPIOA_S size 0x1000
0x54250000 GPIOB_S size 0x1000
0x54260000 GPIOC_S size 0x1000
0x54270000 GPIOD_S size 0x1000
0x54280000 GPIOE_S size 0x1000
0x54290000 GPIOF_S size 0x1000
0x542A0000 GPIOG_S size 0x1000
0x542B0000 GPIOH_S size 0x1000
0x542C0000 GPIOI_S size 0x1000
0x542D0000 GPIOJ_S size 0x1000
0x542E0000 GPIOK_S size 0x1000
0x56000000 RTC_S size 0x400
0x56010000 TAMP_S size 0x400
0x56020000 SPI8_S size 0x400
0x56030000 LPUART1_S size 0x400
0x56040000 I2C8_S size 0x400
0x56050000 LPTIM3_S size 0x400
0x56060000 LPTIM4_S size 0x400
0x56070000 LPTIM5_S size 0xC
0x56080000 I3C4_S size 0x400
0x56090000 IWDG5_S size 0x400
0x560A0000 WWDG2_S size 0x400
0x56200000 GPIOZ_S size 0x1000
0x56210000 LPDMA_S size 0x1000
0x56220000 ADF_S size 0x1000
0x56230000 EXTI2_S size 0x400
0x56240000 HSEM_S size 0x400
0x56250000 IPCC2_S size 0x400
0x58000000 DSI_S size 0x800
0x58010000 LTDC_S size 0x400
0x58020000 CSI_S size 0x2000
0x58030000 DCMIPP_S size 0x1000
0x58040000 DDRCTRL_S size 0x1000
0x58041000 DDRPERFM_S size 0x400
0x58050000 DDRDBG_S size 0x11C
0x58060000 LVDS_S size 0x2000
0x58070000 STGENR size 0x8000 — System timer generator
0x58080000 STGENC_S size 0x1000
0x58090000 GICV2M_S size 0x1000
0x580A0000 UCPD_S size 0x400
0x580C0000 COMBOPHY_S size 0xC4
0x580D0000 VDEC_S size 0x1DC
0x580E0000 VENC_S size 0x7C8
0x58200000 FMC_S size 0x400
0x58220000 SDMMC1_S size 0x400
0x58230000 SDMMC2_S size 0x400
0x58240000 SDMMC3_S size 0x400
0x58280000 GPU_S size 0x668
0x582C0000 ETH1_S size 0x12E4
0x582D0000 ETH2_S size 0x12E4
0x582E0000 USBH_OHCI_S size 0xB0
0x582F0000 USBH_EHCI_S size 0xB0
0x58300000 USB3DR_S size 0x100000
0x58800000 CA35SS_S size 0x20AC
0x58C00000 DDRPHYC_S size 0x3403EC
0x5A010000 DBGMCU_S size 0x50
0x5AC10000 GICD_S size 0x1000
0x5AC20000 GICC_S size 0x1004
0x5AC40000 GICH_S size 0x110
0x5AC60000 GICV_S size 0x1004
0x5C000000 ETHSW_S size 0x1000426

## Interrupts
0 PVD (EXTI1) — PVD detector through EXTI
1 PVM (EXTI1) — PVM detector through EXTI
2 IWDG3 — Independent watchdog 3 early wake interrupt
3 IWDG4 — Independent watchdog 4 early wake interrupt
4 IWDG1_RST (IWDG1) — Independent watchdog 1 reset through EXTI
5 IWDG2_RST (IWDG2) — Independent Watchdog 2 Reset through EXTI
6 IWDG4_RST (IWDG4) — Independent Watchdog 4 Reset through EXTI
7 IWDG5_RST (IWDG5) — Independent Watchdog 5 Reset through EXTI
8 WWDG1 — Window watchdog 1 early wake-up interrupt
11 WWDG2_RST (WWDG2) — Window watchdog 2 reset through EXTI
12 TAMP — Tamper interrupt (include LSECSS interrupts)
13 RTC — RTC global interrupt
14 TAMP_S — Tamper secure interrupt (include LSECSS interrupts)
15 RTC_S — RTC global secure interrupt
16 RCC — RCC global interrupt
{n+17} EXTI2_{n} (EXTI2) (n=0..15) — EXTI2 line {n} interrupt
{n+33} HPDMA1_Channel{n} (HPDMA1) (n=0..15) — HPDMA1 Channel{n} interrupt
{n+49} HPDMA2_Channel{n} (HPDMA2) (n=0..15) — HPDMA2 Channel{n} interrupt
{n+65} HPDMA3_Channel{n} (HPDMA3) (n=0..15) — HPDMA3 Channel{n} interrupt
81 LPDMA1_Channel0 (LPDMA) — LPDMA1 channel 0 interrupt
82 LPDMA1_Channel1 (LPDMA) — LPDMA1 channel 1 interrupt
83 LPDMA1_Channel2 (LPDMA) — LPDMA1 channel 2 interrupt
84 LPDMA1_Channel3 (LPDMA) — LPDMA1 channel 3 interrupt
85 ICACHE — ICACHE interrupt
86 DCACHE — DCACHE interrupt
87 ADC1 — ADC1 interrupt
88 ADC2 — ADC2 interrupt
89 ADC3 (ADCC3) — ADC3 interrupt
90 FDCAN_CAL (FDCAN1) — FDCAN CCU interrupt
91 FDCAN1_IT0 (FDCAN1) — FDCAN1 interrupt 0
92 FDCAN2_IT0 (FDCAN2) — FDCAN2 interrupt 0
93 FDCAN3_IT0 (FDCAN3) — FDCAN3 interrupt 0
94 FDCAN1_IT1 (FDCAN1) — FDCAN1 interrupt 1
95 FDCAN2_IT1 (FDCAN2) — FDCAN2 interrupt 1
96 FDCAN3_IT1 (FDCAN3) — FDCAN3 interrupt 1
97 TIM1_BRK (TIM1) — TIM1 Break interrupt
98 TIM1_UP (TIM1) — TIM1 Update interrupt
99 TIM1_TRG_COM (TIM1) — TIM1 Trigger and Commutation interrupts
100 TIM1_CC (TIM1) — TIM1 Capture Compare interrupt
101 TIM20_BRK (TIM20) — TIM20 Break interrupt
102 TIM20_UP (TIM20) — TIM20 Update interrupt
103 TIM20_TRG_COM (TIM20) — TIM20 Trigger and Commutation interrupts
104 TIM20_CC (TIM20) — TIM20 Capture Compare interrupt
105 TIM2 — TIM2 Global interrupt
106 TIM3 — TIM3 Global interrupt
107 TIM4 — TIM4 Global interrupt
108 I2C1 — I2C1 global interrupt
109 I3C1 — I3C1 global interrupt
110 I2C2 — I2C2 global interrupt
111 I3C2 — I3C2 global interrupt
112 SPI1 — SPI1 global interrupt
113 SPI2 — SPI2 global interrupt
114 USART1 — USART1 Global interrupt
115 USART2 — USART2 Global interrupt
116 USART3 — USART3 Global interrupt
117 VDEC — VDEC Global interrupt
118 TIM8_BRK (TIM8) — TIM8 Break interrupt
119 TIM8_UP (TIM8) — TIM8 Update interrupt
120 TIM8_TRG_COM (TIM8) — TIM8 Trigger and Commutation interrupts
121 TIM8_CC (TIM8) — TIM8 Capture Compare interrupt
122 FMC — FMC Global interrupt
123 SDMMC1 — SDMMC1 global interrupt
124 TIM5 — TIM5 Global interrupt
125 SPI3 — SPI3 global interrupt
126 UART4 — UART4 Global interrupt
127 UART5 — UART5 Global interrupt
128 TIM6 — TIM6 Global interrupt
129 TIM7 (TIM6) — TIM7 Global interrupt
130 ETH1_SBD (ETH1) — ETH1 global interrupt
131 ETH1_PMT (ETH1) — ETH1 wakeup interrupt (PMT)
132 ETH1_LPI (ETH1) — ETH1 LPI interrupt
133 ETH2_SBD (ETH2) — ETH2 global interrupt
134 ETH2_PMT (ETH2) — ETH2 wakeup interrupt (PMT)
135 ETH2_LPI (ETH2) — ETH2 LPI interrupt
136 USART6 — USART6 Global interrupt
137 I2C3 — I2C3 global interrupt
138 I3C3 — I3C3 global interrupt
139 USBH_EHCI — USB Host EHCI interrupt
140 USBH_OHCI (USBH_EHCI) — USB Host OHCI interrupt
141 DCMI_PSSI (DCMI) — DCACHE interrupt
142 CSI2HOST (CSI) — CSI2 Host controller interrupt
143 DSI — DSI Host controller global interrupt
144 CRYP1 — Crypto1 interrupt
145 HASH — HASH interrupt
146 PKA — PKA interrupt
147 FPU (EXTI1) — FPU global interrupt
148 UART7 — UART7 Global interrupt
149 UART8 — UART8 Global interrupt
150 UART9 — UART9 Global interrupt
151 LPUART1 — LPUART1 Global interrupt
152 SPI4 — SPI4 global interrupt
153 SPI5 — SPI5 global interrupt
154 SPI6 — SPI6 global interrupt
155 SPI7 — SPI7 global interrupt
156 SPI8 — SPI8 global interrupt
157 SAI1 — SAI1 global interrupt
158 LTDC_IRQ (LTDC) — LTDC global interrupt
159 LTDC_ER_IRQ (LTDC) — LTDC global error interrupt
160 LTDC_SEC_IRQ (LTDC) — LTDC security global interrupt
161 LTDC_SEC_ER_IRQ (LTDC) — LTDC security global error interrupt
162 SAI2 — SAI2 global interrupt
163 OCTOSPI1 — OCTOSPI1 global interrupt
164 OCTOSPI2 (OCTOSPI1) — OCTOSPI2 global interrupt
165 OTFDEC1 — OTFDEC1 interrupt
166 LPTIM1 — LPTIMER1 global interrupt
167 VENC — VENC Global interrupt
168 I2C4 — I2C4 global interrupt
169 USBH_WAKEUP (USBH_EHCI) — USBH remote wake-up from USB2PHY1
170 SPDIFRX — SPDIFRX global interrupt
171 IPCC1_RX (IPCC1) — Mailbox 1 Rx Occupied interrupt
172 IPCC1_TX (IPCC1) — Mailbox 1 Tx Free interrupt
173 IPCC1_RX_S (IPCC1) — Mailbox 1 Rx Occupied secure interrupt
174 IPCC1_TX_S (IPCC1) — Mailbox 1 Tx Free secure interrupt
175 IPCC2_RX (IPCC2) — Mailbox 2 Rx Occupied interrupt
176 IPCC2_TX (IPCC2) — Mailbox 2 Tx Free interrupt
177 IPCC2_RX_S (IPCC2) — Mailbox 2 Rx Occupied secure interrupt
178 IPCC2_TX_S (IPCC2) — Mailbox 2 Tx Free secure interrupt
179 SAES — Secure AES
180 CRYP2 — Crypto2 interrupt
181 I2C5 — I2C5 global interrupt
182 USB3DR_WAKEUP (USB3DR) — USB3DR remote wake-up from USB2PHY2
183 GPU — GPU Global interrupt
{n+184} MDF1_FLT{n} (MDF1) (n=0..7) — MDF1 Filter{n} Interrupt
192 SAI3 — SAI3 global interrupt
193 TIM15 — TIM15 Global interrupt
194 TIM16 — TIM16 Global interrupt
195 TIM17 — TIM17 Global interrupt
196 TIM12 — LTIM12 global interrupt
197 SDMMC2 — SDMMC2 global interrupt
198 DCMIPP — DCMIPP global interrupt
199 HSEM — HSEM semaphore non-secure interrupt
200 HSEM_S — HSEM semaphore secure interrupt
203 TIM13 — LTIM13 global interrupt
204 TIM14 — LTIM14 global interrupt
205 TIM10 — LTIM10 global interrupt
206 RNG — RNG interrupt
207 ADF1_FLT (ADF) — ADF1 Filter interrupt
208 I2C6 — I2C6 global interrupt
209 COMBOPHY_WAKEUP (COMBOPHY) — COMBOPHY LFPS start request
210 I2C7 — I2C7 global interrupt
212 I2C8 — I2C8 global interrupt
213 I3C4 — I3C4 global interrupt
214 SDMMC3 — SDMMC3 global interrupt
215 LPTIM2 — LPTIMER2 global interrupt
216 LPTIM3 — LPTIMER3 global interrupt
217 LPTIM4 — LPTIMER4 global interrupt
218 LPTIM5 — LPTIMER5 global interrupt
219 OTFDEC2 (OTFDEC1) — OTFDEC2 interrupt
220 CPU1_SEV (EXTI1) — Cortex-A35 send event through EXTI
221 CPU3_SEV (EXTI1) — Cortex-M0+ send event through EXTI
222 RCC_WAKEUP (RCC) — RCC CPU2 Wake up interrupt
223 SAI4 — SAI4 global interrupt
224 DTS — Temperature sensor interrupt
225 TIM11 — LTIM11 global interrupt
227 USB3DR_BC (USB3DR) — USB3 BC interrupt
228 USB3DR — USB3 interrupt
229 UCPD1 (UCPD) — USB PD interrupt
240 SERC — SERC global interrupt
242 RAMCFG — RAM configuration global interrupt
243 DDRCTRL — DDRCTRL interrupt
244 DDRPHYC — DDRPHYC interrupt (active low)
245 DDRPHYC_ERR (DDRPHYC) — DFI error interrupt
246 IAC — RIF Illegal access Controller interrupt
250 ETHSW — Ethernet switch global interrupt
251 ETHSW_MSGBUF (ETHSW) — Ethernet ACM message buffer interrupt
252 ETHSW_FSC (ETHSW) — Ethernet ACM scheduler interrupt
253 HPDMA1_WKUP (HPDMA1) — HPDMA1 channel 0 to 15 wake up
254 HPDMA2_WKUP (HPDMA2) — HPDMA2 channel 0 to 15 wake up
255 HPDMA3_WKUP (HPDMA3) — HPDMA3 channel 0 to 15 wake up
256 LPDMA1_WKUP (LPDMA) — LPDMA1 channel 0 to 3 wakeup
257 UCPD_VBUS_VALID (UCPD) — USB Type C VBUS valid
258 UCPD_VBUS_VSAFE5V (UCPD) — USB Type C VSAFE5V
259 RCC_HSI_FMON (RCC) — HSI Frequency Monitor
{n+268} EXTI1_{n} (EXTI1) (n=0..15) — EXTI1 line {n} interrupt
310 DDRPERFM — DDR performance monitor interrupt

## Notices in the file
Copyright (c) 2025 STMicroelectronics.
SPDX-License-Identifier: Apache-2.0
Licensed under the Apache License, Version 2.0 (the "License");
you may not use this file except in compliance with the License.
You may obtain a copy of the License at
http://www.apache.org/licenses/LICENSE-2.0
Unless required by applicable law or agreed to in writing, software
distributed under the License is distributed on an "AS IS" BASIS,
WITHOUT WARRANTIES OR CONDITIONS OF ANY KIND, either express or implied.
See the License for the specific language governing permissions and
limitations under the License.
