# STM32MP21_CA35 register map
File version: 0.4
CPU: CM33 r0p1, little endian, MPU, FPU, vendor SysTick, 8 interrupt priority bits
Registers are 32-bit, read-write, reset 0x0 unless marked. A register's access mark holds for its fields unless they carry their own. Offsets are from the block's base; lines under a group give offsets from that group; [hi:lo] are bit positions; {n}, {i} and the like mark numbered series; 'fields as' and 'values as' point back to an identical list; <NAME> marks a mode.

## Memory map
0x40000000 TIM2 size 0x400 — TIM2 address block description
0x40010000 TIM3 size 0x400 — TIM3 address block description
0x40020000 TIM4 size 0x400 — TIM4 address block description
0x40030000 TIM5 size 0x400 — TIM5 address block description
0x40040000 TIM6 size 0x400 — TIM6 address block description
0x40050000 TIM7 size 0x400 — TIM7 address block description
0x40060000 TIM12 size 0x400 — TIM12 address block description
0x40070000 TIM13 size 0x400 — TIM13 address block description
0x40080000 TIM14 size 0x400 — TIM14 address block description
0x40090000 LPTIM1 size 0x400 — LPTIM1 address block description
0x400A0000 LPTIM2 size 0x400 — LPTIM2 address block description
0x400B0000 SPI2 size 0x400
0x400C0000 SPI3 size 0x400
0x400D0000 SPDIFRX size 0x400 — SPDIFRX address block description
0x400E0000 USART2 size 0x400
0x400F0000 USART3 size 0x400
0x40100000 UART4 size 0x400
0x40110000 UART5 size 0x400
0x40170000 I2C1 size 0x400 — I2C address block description
0x40180000 I2C2 size 0x400
0x40190000 I3C1 size 0x400 — I3C register block
0x401A0000 I3C2 size 0x400
0x401C0000 TIM10 size 0x400 — TIM10 address block description
0x401D0000 TIM11 size 0x400 — TIM11 address block description
0x40200000 TIM1 size 0x400 — TIM1 address block description
0x40210000 TIM8 size 0x400 — TIM8 address block description
0x40220000 USART6 size 0x400
0x40230000 SPI1 size 0x400 — SPI address block description
0x40240000 SPI4 size 0x400
0x40250000 TIM15 size 0x400 — TIM15 address block description
0x40260000 TIM16 size 0x400 — TIM16 address block description
0x40270000 TIM17 size 0x400 — TIM17 address block description
0x40280000 SPI5 size 0x400
0x40290000 SAI1 size 0x400 — SAI register block
0x402A0000 SAI2 size 0x400
0x402B0000 SAI3 size 0x400
0x402D0000 FDCAN1 size 0x304 — FDCAN address block description
0x402E0000 FDCAN2 size 0x304
0x40330000 USART1 size 0x400 — USART register block
0x40340000 SAI4 size 0x400
0x40370000 UART7 size 0x400
0x40400000 HPDMA1 size 0x1000 — HPDMA register block
0x40410000 HPDMA2 size 0x1000
0x40420000 HPDMA3 size 0x1000
0x40430000 OCTOSPI1 size 0x400 — OCTOSPI register block
0x40450000 OTFDEC size 0x400 — OTFDEC register bank
0x40470000 ICACHE size 0x400 — ICACHE register block
0x40480000 DCACHE size 0x400 — DCACHE register block
0x40490000 IPCC size 0x400 — IPCC address block description
0x404A0000 DCMI size 0x400 — DCMI address block description
0x404B0000 PSSI size 0x400 — PSSI register block
0x404C0000 CRC size 0x18 — CRC address block description
0x404D0000 MDF1 size 0x1000 — MDF register block
0x404E0000 ADC1 size 0x100 — ADC register block
0x404E0300 ADC12 size 0x100 — ADC12 register block
0x404F0000 ADC2 size 0x100
0x42010000 HASH2 size 0x400
0x42020000 RNG2 size 0x400
0x42030000 CRYP1 size 0x400 — CRYP address block description
0x42030400 HASH1 size 0x400 — HASH register bank
0x42030800 RNG1 size 0x400 — RNG address block description
0x42030C00 SAES size 0x400 — SAES register block
0x42032000 PKA size 0x2000 — PKA register blank and RAM
0x42040000 CRYP2 size 0x400
0x42070000 RAMCFG size 0xFFF — RAMCFG register bank
0x42080000 RIFSC size 0x1000 — RIFSC register block
0x42090000 IAC size 0x400 — IAC register block
0x420A0000 RISAF1 size 0x1E20 — RISAF register block
0x420B0000 RISAF2 size 0x1E20 — RISAF register block
0x420D0000 RISAF4 size 0x1E20 — RISAF register block
0x420F0000 RISAB1 size 0x1000 — RISAB1 register block
0x42100000 RISAB2 size 0x1000 — RISAB2 register block
0x42110000 RISAB3 size 0x1000 — RISAB3 register block
0x42130000 RISAB5 size 0x1000 — RISAB5 register block
0x44000000 BSEC size 0x1000 — BSEC register block
0x44010000 IWDG1 size 0x400 — IWDG address block description
0x44020000 IWDG2 size 0x400
0x44030000 IWDG3 size 0x400
0x44040000 IWDG4 size 0x400
0x44050000 WWDG size 0x400 — WWDG address block description
0x44060000 VREFBUF size 0x8 — VREFBUF address block description
0x44070000 DTS size 0x130 — DTS address block description
0x44080000 SERC size 0x400 — SERC register block
0x44090000 HDP size 0x400 — HDP address block description
0x440A0000 DBGMCU size 0x10C — DBGMCU address block description
0x44200000 RCC size 0x10000 — RCC register block
0x44210000 PWR size 0x400 — PWR register block
0x44220000 EXTI1 size 0x400 — EXTI1 address block description
0x44230000 SYSCFG size 0x8000 — SYSCFG register block
0x44240000 GPIOA size 0x1000 — Control of ioport A
0x44250000 GPIOB size 0x1000 — Control of ioport B
0x44260000 GPIOC size 0x1000 — Control of ioport C
0x44270000 GPIOD size 0x1000 — Control of ioport D
0x44280000 GPIOE size 0x1000 — Control of ioport E
0x44290000 GPIOF size 0x1000 — Control of ioport F
0x442A0000 GPIOG size 0x1000 — Control of ioport G
0x442B0000 GPIOH size 0x1000 — Control of ioport H
0x442C0000 GPIOI size 0x1000 — Control of ioport I
0x442D0000 EXTI2 size 0x400 — EXTI2 address block description
0x46000000 RTC size 0x400 — RTC register block
0x46010000 TAMP size 0x400 — TAMP register block
0x46020000 SPI6 size 0x400
0x46030000 LPUART size 0x400 — LPUART address block description
0x46040000 I2C3 size 0x400
0x46050000 LPTIM3 size 0x400 — LPTIM3 address block description
0x46060000 LPTIM4 size 0x400 — LPTIM4 address block description
0x46070000 LPTIM5 size 0x400 — LPTIM5 address block description
0x46080000 I3C3 size 0x400
0x46200000 GPIOZ size 0x1000 — Control of ioport Z
0x48010000 LTDC size 0x400 — LTDC register block
0x48020000 CSI size 0x2000 — CSI address block description
0x48030000 DCMIPP size 0x1000 — DCMIPP register block
0x48040000 DDRCTRL size 0xFF8 — DDRCTRL register block
0x48050000 DDRDBG size 0x11C — DDRDBG address block description
0x48070000 STGENR size 0x1000 — STGENR address block description
0x48080000 STGENC size 0x1000 — STGENC address block description
0x480C0000 DDRPERFM size 0x400 — DDRPERFM register block
0x48200000 FMC size 0x400 — FMC address block description
0x48220000 SDMMC1 size 0x400 — SDMMC address block description
0x48230000 SDMMC2 size 0x400
0x48240000 SDMMC3 size 0x400
0x482C0000 ETH1 size 0x12E4 — ETH address block description
0x482D0000 ETH2 size 0x12E4
0x482E0000 USBH_OHCI size 0xB0
0x482F0000 USBH_EHCI size 0xB0 — USBH address block description
0x48300000 OTG size 0xE08 — OTG address block description
0x48800000 CA35SS size 0x20AC — CA35SS register block
0x48C00000 DDRPHYC size 0x3403EC — DDRPHYC address block description
0x4AC10000 GICD size 0x1000 — GICD address block description
0x4AC20000 GICC size 0x1004 — GICC address block description
0x4AC40000 GICH size 0x110 — GICH address block description
0x4AC60000 GICV size 0x1004 — GICV address block description
0x50000000 TIM2_S size 0x400
0x50010000 TIM3_S size 0x400
0x50020000 TIM4_S size 0x400
0x50030000 TIM5_S size 0x400
0x50040000 TIM6_S size 0x400
0x50050000 TIM7_S size 0x400
0x50060000 TIM12_S size 0x400
0x50070000 TIM13_S size 0x400
0x50080000 TIM14_S size 0x400
0x50090000 LPTIM1_S size 0x400
0x500A0000 LPTIM2_S size 0x400
0x500B0000 SPI2_S size 0x400
0x500C0000 SPI3_S size 0x400
0x500D0000 SPDIFRX_S size 0x400
0x500E0000 USART2_S size 0x400
0x500F0000 USART3_S size 0x400
0x50100000 UART4_S size 0x400
0x50110000 UART5_S size 0x400
0x50170000 I2C1_S size 0x400
0x50180000 I2C2_S size 0x400
0x50190000 I3C1_S size 0x400
0x501A0000 I3C2_S size 0x400
0x501C0000 TIM10_S size 0x400
0x501D0000 TIM11_S size 0x400
0x50200000 TIM1_S size 0x400
0x50210000 TIM8_S size 0x400
0x50220000 USART6_S size 0x400
0x50230000 SPI1_S size 0x400
0x50240000 SPI4_S size 0x400
0x50250000 TIM15_S size 0x400
0x50260000 TIM16_S size 0x400
0x50270000 TIM17_S size 0x400
0x50280000 SPI5_S size 0x400
0x50290000 SAI1_S size 0x400
0x502A0000 SAI2_S size 0x400
0x502B0000 SAI3_S size 0x400
0x502D0000 FDCAN1_S size 0x304
0x502E0000 FDCAN2_S size 0x304
0x50330000 USART1_S size 0x400
0x50340000 SAI4_S size 0x400
0x50370000 UART7_S size 0x400
0x50400000 HPDMA1_S size 0x1000
0x50410000 HPDMA2_S size 0x1000
0x50420000 HPDMA3_S size 0x1000
0x50430000 OCTOSPI1_S size 0x400
0x50450000 OTFDEC_S size 0x400
0x50470000 ICACHE_S size 0x400
0x50480000 DCACHE_S size 0x400
0x50490000 IPCC_S size 0x400
0x504A0000 DCMI_S size 0x400
0x504B0000 PSSI_S size 0x400
0x504C0000 CRC_S size 0x18
0x504D0000 MDF1_S size 0x1000
0x504E0000 ADC1_S size 0x100
0x504E0300 ADC12_S size 0x100
0x504F0000 ADC2_S size 0x100
0x52010000 HASH2_S size 0x400
0x52020000 RNG2_S size 0x400
0x52030000 CRYP1_S size 0x400
0x52030400 HASH1_S size 0x400
0x52030800 RNG1_S size 0x400
0x52030C00 SAES_S size 0x400
0x52032000 PKA_S size 0x2000
0x52040000 CRYP2_S size 0x400
0x52070000 RAMCFG_S size 0xFFF
0x52080000 RIFSC_S size 0x1000
0x52090000 IAC_S size 0x400
0x520A0000 RISAF1_S size 0x1E20
0x520B0000 RISAF2_S size 0x1E20
0x520D0000 RISAF4_S size 0x1E20
0x520F0000 RISAB1_S size 0x1000
0x52100000 RISAB2_S size 0x1000
0x52110000 RISAB3_S size 0x1000
0x52130000 RISAB5_S size 0x1000
0x54000000 BSEC_S size 0x1000
0x54010000 IWDG1_S size 0x400
0x54020000 IWDG2_S size 0x400
0x54030000 IWDG3_S size 0x400
0x54040000 IWDG4_S size 0x400
0x54050000 WWDG_S size 0x400
0x54060000 VREFBUF_S size 0x8
0x54070000 DTS_S size 0x130
0x54080000 SERC_S size 0x400
0x54090000 HDP_S size 0x400
0x540A0000 DBGMCU_S size 0x10C
0x54200000 RCC_S size 0x10000
0x54210000 PWR_S size 0x400
0x54220000 EXTI1_S size 0x400
0x54230000 SYSCFG_S size 0x8000
0x54240000 GPIOA_S size 0x1000
0x54250000 GPIOB_S size 0x1000
0x54260000 GPIOC_S size 0x1000
0x54270000 GPIOD_S size 0x1000
0x54280000 GPIOE_S size 0x1000
0x54290000 GPIOF_S size 0x1000
0x542A0000 GPIOG_S size 0x1000
0x542B0000 GPIOH_S size 0x1000
0x542C0000 GPIOI_S size 0x1000
0x542D0000 EXTI2_S size 0x400
0x56000000 RTC_S size 0x400
0x56010000 TAMP_S size 0x400
0x56020000 SPI6_S size 0x400
0x56030000 LPUART_S size 0x400
0x56040000 I2C3_S size 0x400
0x56050000 LPTIM3_S size 0x400
0x56060000 LPTIM4_S size 0x400
0x56070000 LPTIM5_S size 0x400
0x56080000 I3C3_S size 0x400
0x56200000 GPIOZ_S size 0x1000
0x58010000 LTDC_S size 0x400
0x58020000 CSI_S size 0x2000
0x58030000 DCMIPP_S size 0x1000
0x58040000 DDRCTRL_S size 0xFF8
0x58050000 DDRDBG_S size 0x11C
0x58070000 STGENR_S size 0x1000
0x58080000 STGENC_S size 0x1000
0x580C0000 DDRPERFM_S size 0x400
0x58200000 FMC_S size 0x400
0x58220000 SDMMC1_S size 0x400
0x58230000 SDMMC2_S size 0x400
0x58240000 SDMMC3_S size 0x400
0x582C0000 ETH1_S size 0x12E4
0x582D0000 ETH2_S size 0x12E4
0x582E0000 USBH_OHCI_S size 0xB0
0x582F0000 USBH_EHCI_S size 0xB0
0x58300000 OTG_S size 0xE08
0x58800000 CA35SS_S size 0x20AC
0x58C00000 DDRPHYC_S size 0x3403EC
0x5AC10000 GICD_S size 0x1000
0x5AC20000 GICC_S size 0x1004
0x5AC40000 GICH_S size 0x110
0x5AC60000 GICV_S size 0x1004

## Interrupts
0 PVD (EXTI1) — PVD detector through EXTI
1 PVM (EXTI1) — PVM detector through EXTI
2 IWDG1 — Independent watchdog 3 early wake interrupt
3 IWDG2 (IWDG1) — Independent watchdog 4 early wake interrupt
4 IWDG3_RST (IWDG1) — Independent Watchdog 1 Reset through EXTI
5 IWDG2_RST (IWDG1) — Independent Watchdog 2 Reset through EXTI
6 IWDG4_RST (IWDG1) — Independent Watchdog 4 Reset through EXTI
9 WWDG1_RST (WWDG) — Window watchdog 1 reset through EXTI
10 TAMP — Tamper interrupt (include LSECSS interrupts).
11 RTC — RTC global interrupt
12 TAMP_S (TAMP) — Tamper secure interrupt (include LSECSS interrupts).
13 RTC_S (RTC) — RTC global secure interrupt
14 RCC — RCC global interrupt
{n+15} EXT2_{n} (EXTI2) (n=0..15) — EXT2 line {n} interrupt.
{n+31} HPDMA1_Channel{n} (HPDMA1) (n=0..15) — HPDMA1 Channel{n} interrupt
{n+47} HPDMA2_Channel{n} (HPDMA1) (n=0..15) — HPDMA2 Channel{n} interrupt
{n+63} HPDMA3_Channel{n} (HPDMA1) (n=0..15) — HPDMA3 Channel{n} interrupt
79 ICACHE — ICACHE interrupt
80 DCACHE — DCACHE interrupt.
81 ADC1 — ADC1 interrupt
82 ADC2 — ADC2 interrupt
83 FDCAN_CAL (FDCAN1) — FDCAN CCU interrupt
84 FDCAN1_IT0 (FDCAN1) — FDCAN1 interrupt 0
85 FDCAN2_IT0 (FDCAN1) — FDCAN2 interrupt 0
86 FDCAN1_IT1 (FDCAN1) — FDCAN1 interrupt 1
87 FDCAN2_IT1 (FDCAN1) — FDCAN2 interrupt 1
88 TIM1_BRK (TIM1) — TIM1 Break interrupt
89 TIM1_UP (TIM1) — TIM1 Update interrupt
90 TIM1_TRG_COM (TIM1) — TIM1 Trigger and Commutation interrupts
91 TIM1_CC (TIM1) — TIM1 Capture Compare interrupt
92 TIM2 — TIM2 Global interrupt
93 TIM3 — TIM3 Global interrupt
94 TIM4 — TIM4 Global interrupt
95 I2C1 — I2C1 global interrupt
96 I3C1 — I3C1 global interrupt
97 I2C2 (I2C1) — I2C2 global interrupt
98 I3C2 (I3C1) — I3C2 global interrupt
99 SPI1 — SPI1 global interrupt
100 SPI2 — SPI2 global interrupt
101 USART1 — USART1 Global interrupt
102 USART2 (USART1) — USART2 Global interrupt
103 USART3 (USART1) — USART3 Global interrupt
105 TIM8_BRK (TIM8) — TIM8 Break interrupt
106 TIM8_UP (TIM8) — TIM8 Update interrupt
107 TIM8_TRG_COM (TIM8) — TIM8 Trigger and Commutation interrupts
108 TIM8_CC (TIM8) — TIM8 Capture Compare interrupt
109 FMC — FMC Global interrupt
110 SDMMC1 — SDMMC1 global interrupt
111 TIM5 — TIM5 Global interrupt
112 SPI3 — SPI3 global interrupt
113 UART4 (USART1) — UART4 Global interrupt
114 UART5 (USART1) — UART5 Global interrupt
115 TIM6 — TIM6 Global interrupt
116 TIM7 — TIM7 Global interrupt
117 ETH1_SBD (ETH1) — ETH1 global interrupt
118 ETH1_PMT (ETH1) — ETH1 wakeup interrupt (PMT)
119 ETH1_LPI (ETH1) — ETH1 LPI interrupt
120 ETH2_SBD (ETH1) — ETH2 global interrupt
121 ETH2_PMT (ETH1) — ETH2 wakeup interrupt (PMT)
122 ETH2_LPI (ETH1) — ETH2 LPI interrupt
123 USART6 (USART1) — USART6 Global interrupt
124 I2C3 (I2C1) — I2C3 global interrupt
125 I3C3 (I3C1) — I3C3 global interrupt
126 USBH_EHCI — USB Host EHCI interrupt
127 USBH_OHCI (USBH_EHCI) — USB Host OHCI interrupt
128 DCMI_PSSI (DCMI) — DCACHE interrupt
131 CRYP1 — Crypto1 interrupt
132 HASH1 — HASH1 interrupt
133 PKA — PKA interrupt
134 FPU (EXTI1) — FPU global interrupt.
135 UART7 (USART1) — UART7 Global interrupt
136 LPUART1 (LPUART) — LPUART1 Global interrupt
137 SPI4 — SPI4 global interrupt
138 SPI5 — SPI5 global interrupt
139 SPI6 — SPI6 global interrupt
140 SAI1 — SAI1 global interrupt
141 LTDC_IRQ (LTDC) — LTDC global interrupt
142 LTDC_ER_IRQ (LTDC) — LTDC global error interrupt
143 LTDC_SEC_IRQ (LTDC) — LTDC security global interrupt
144 LTDC_SEC_ER_IRQ (LTDC) — LTDC security global error interrupt
145 SAI2 (SAI1) — SAI2 global interrupt
146 OCTOSPI1 — OCTOSPI1 global interrupt
148 OTFDEC1 (OTFDEC) — OTFDEC1 interrupt
149 LPTIM1 — LPTIMER1 global interrupt.
150 USBH_WAKEUP (USBH_EHCI) — USBH remote wakeup from USB2PHY1t
151 SPDIFRX — SPDIFRX global interrupt
152 IPCC1_RX (IPCC) — Mailbox 1 Rx Occupied interrupt
153 IPCC1_TX (IPCC) — Mailbox 1 Tx Free interrupt
154 IPCC1_RX_S (IPCC) — Mailbox 1 Rx Occupied secure interrupt
155 IPCC1_TX_S (IPCC) — Mailbox 1 Tx Free secure interrupt
156 SAES — Secure AES
157 CRYP2 — Crypto2 interrupt
158 OTG_WAKEUP (OTG) — USB2 DR remote wakeup from USB2PHY2
160 MDF1_FLT0 (MDF1) — MDF1 Filter0 Interrupt
161 MDF1_FLT1 (MDF1) — MDF1 Filter1 Interrupt
162 MDF1_FLT2 (MDF1) — MDF1 Filter2 Interrupt
163 MDF1_FLT3 (MDF1) — MDF1 Filter3 Interrupt
164 SAI3 (SAI1) — SAI3 global interrupt
165 TIM15 — LTIM15 global interrupt
166 TIM16 — LTIM16 global interrupt
167 TIM17 — LTIM17 global interrupt
168 TIM12 — LTIM12 global interrupt
169 SDMMC2 (SDMMC1) — SDMMC2 global interrupt
170 DCMIPP — DCMIPP global interrupt
171 nCTIIRQ1 (EXTI1) — Cortex-M33 CTI interrupt 1.
172 nCTIIRQ2 (EXTI1) — Cortex-M33 CTI interrupt 2.
173 TIM13 — LTIM13 global interrupt
174 TIM14 — LTIM14 global interrupt
175 TIM10 — LTIM10 global interrupt
176 RNG1 — RNG1 interrupt
178 HASH2 — HASH2 interrupt
179 SDMMC3 (SDMMC1) — SDMMC3 global interrupt
180 LPTIM2 — LPTIMER2 global interrupt.
181 LPTIM3 — LPTIMER3 global interrupt.
182 LPTIM4 — LPTIMER4 global interrupt.
183 LPTIM5 — LPTIMER5 global interrupt.
186 RCC_WAKEUP (RCC) — RCC CPU2 Wake up interrupt
187 SAI4 (SAI1) — SAI4 global interrupt
188 DTS — Temperature sensor interrupt
189 TIM11 — LTIM11 global interrupt
190 CPU2_WAKEUP_PIN (EXTI1) — Interrupt for all 6 wakeup enabled by CPU2.
191 OTG — USB2 DR global interrupt
192 RNG2 (RNG1) — RNG2 interrupt
195 SERF (EXTI1) — SERF global interrupt.
197 RAMCFG — RAM configuration global interrupt
198 DDRCTRL — DDRCTRL interrupt
199 DDRPHYC — DDRPHYC interrupt (active low)
201 IAC — RIF Illegal access Controller interrupt
205 HPDMA1_WKUP (HPDMA1) — HPDMA1 channel 0 to 15 wakeup.
206 HPDMA2_WKUP (HPDMA1) — HPDMA2 channel 0 to 15 wakeup.
207 HPDMA3_WKUP (HPDMA1) — HPDMA3 channel 0 to 15 wakeup.
210 RCC_HSI_FMON (RCC) — HSI Frequency Monitor
211 RCC_MSI_FMON (RCC) — MSI Frequency Monitor
245 DDRPHYC_DFI (DDRPHYC) — DFI error interrupt
{n+268} EXT1_{n} (EXTI1) (n=0..15) — EXT1 line {n} interrupt.
310 DDRPERFM — DDR performance monitor interrupt

## Notices in the file
Copyright (c) 2024 STMicroelectronics.
SPDX-License-Identifier: Apache-2.0
Licensed under the Apache License, Version 2.0 (the "License");
you may not use this file except in compliance with the License.
You may obtain a copy of the License at
http://www.apache.org/licenses/LICENSE-2.0
Unless required by applicable law or agreed to in writing, software
distributed under the License is distributed on an "AS IS" BASIS,
WITHOUT WARRANTIES OR CONDITIONS OF ANY KIND, either express or implied.
See the License for the specific language governing permissions and
limitations under the License.
